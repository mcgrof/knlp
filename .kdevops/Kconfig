## gpt2/Kconfig.mechint
```kconfig
# SPDX-License-Identifier: MIT
# Mechanistic Interpretability and Analysis Configuration

menu "Mechanistic Interpretability Options"

config KNLP_MECHINT
	bool "Enable mechanistic interpretability tooling"
	default n
	help
	  Enable optional tools used to run mechanistic interpretability passes,
	  such as sparse KV feature-circuit analysis, binary masking over K/V
	  channels, and ablation workflows. These options operate on trained
	  model checkpoints or existing run directories.

	  When enabled, you can run post-training analysis to identify sparse
	  circuits that drive specific behaviors or metrics. This follows the
	  approach from "Scaling Sparse Feature Circuit Finding" where binary
	  masks are optimized over KV channels while keeping model weights frozen.

	  These tools are intended for analysis runs, not production training.

if KNLP_MECHINT

choice
	prompt "KV Feature-Circuit Analysis Mode"
	default KNLP_MECHINT_KV_POSTTRAIN
	help
	  Choose how sparse KV feature-circuit analysis should be performed:

	    1. Post-training ablation:
	         Runs a fresh KV feature-mask optimization pass on a trained
	         checkpoint, freezing core model weights and optimizing only the
	         KV channel mask.

	    2. Existing run directory:
	         Instead of running the analysis, point this workflow to an
	         existing directory of saved mechanistic interpretability runs.

config KNLP_MECHINT_KV_POSTTRAIN
	bool "Run post-training KV feature-mask ablation"
	help
	  Run a post-training mechanistic interpretability pass that optimizes
	  a learnable binary mask over attention K/V channels. This identifies
	  sparse feature circuits that drive a chosen metric or behavior.

	  The analysis works by:
	  1. Loading a trained checkpoint
	  2. Freezing all model weights
	  3. Injecting learnable KV feature masks into attention layers
	  4. Optimizing masks to maintain target metric while maximizing sparsity
	  5. Saving circuit visualizations and importance scores

	  This follows the continuous sparsification approach from the Gemma 9B
	  sparse circuit paper, using straight-through estimators for binary
	  masks while allowing gradient flow for optimization.

config KNLP_MECHINT_KV_FROM_RUNS
	bool "Use existing mechanistic analysis run directory"
	help
	  Use a preexisting directory containing saved KV feature-mask runs,
	  circuit logs, or ablation traces instead of launching a new analysis.

	  This is useful for:
	  - Visualizing previously completed analyses
	  - Comparing circuits across multiple checkpoints
	  - Generating figures without rerunning expensive optimization

endchoice

config KNLP_MECHINT_KV_RUN_DIR
	string "Path to existing mechanistic analysis run directory"
	depends on KNLP_MECHINT_KV_FROM_RUNS
	default ""
	help
	  Path to a directory containing existing mechanistic interpretability
	  analysis outputs. These may include learned masks, ablation logs, or
	  per-layer feature-importance visualizations. Used when not performing
	  a new post-training analysis.

	  Example: /path/to/mechint_runs/gpt2_circuit_analysis_20240315

config KNLP_MECHINT_KV_CHECKPOINT
	string "Path to checkpoint for post-training analysis"
	depends on KNLP_MECHINT_KV_POSTTRAIN
	default ""
	help
	  Path to the trained model checkpoint (.pt file) to analyze. The
	  checkpoint should contain model state_dict with attention layers.

	  If empty, will attempt to use the best checkpoint from the most
	  recent training run.

config KNLP_MECHINT_KV_TARGET_METRIC
	string "Metric to optimize during KV channel mask learning"
	depends on KNLP_MECHINT_KV_POSTTRAIN
	default "loss"
	help
	  The metric the KV feature-mask optimizer should attempt to minimize or
	  maximize during post-training analysis.

	  Options:
	  - "loss": Minimize validation loss (standard)
	  - "accuracy": Maximize accuracy (for classification tasks)
	  - "perplexity": Minimize perplexity
	  - "logit_diff": Maximize logit difference for specific behaviors
	  - "kl_div": Minimize KL divergence from original model outputs

	  The optimizer will find the sparsest KV channel mask that maintains
	  this metric close to the original model's performance.

config KNLP_MECHINT_KV_TARGET_SPARSITY
	string "Target sparsity for KV feature mask"
	depends on KNLP_MECHINT_KV_POSTTRAIN
	default "0.95"
	help
	  Target fraction of KV channels to prune during circuit discovery.
	  Higher values find sparser circuits but may sacrifice faithfulness.

	  Examples:
	  - 0.90: Keep 10% of channels (aggressive sparsity)
	  - 0.95: Keep 5% of channels (very sparse, similar to Gemma 9B paper)
	  - 0.80: Keep 20% of channels (more conservative)

	  The continuous sparsification schedule will gradually increase
	  sparsity toward this target while monitoring metric degradation.

config KNLP_MECHINT_KV_STEPS
	int "Steps for KV mask optimization"
	depends on KNLP_MECHINT_KV_POSTTRAIN
	default 500
	help
	  Number of optimization steps used to fit the sparse mask over attention
	  K/V channels during the post-training analysis phase.

	  Typical values:
	  - 500: Quick analysis (5-10 minutes on single GPU)
	  - 1000: Standard analysis (10-20 minutes)
	  - 2000: Thorough analysis for publication-quality circuits

config KNLP_MECHINT_KV_LR
	string "Learning rate for mask optimization"
	depends on KNLP_MECHINT_KV_POSTTRAIN
	default "0.01"
	help
	  Learning rate for optimizing the KV feature mask logits. Higher
	  values converge faster but may be less stable.

	  Recommended:
	  - 0.01: Standard for most models
	  - 0.001: More stable for sensitive metrics
	  - 0.1: Faster convergence for simple tasks

config KNLP_MECHINT_KV_TEMP_SCHEDULE
	string "Temperature schedule for mask relaxation"
	depends on KNLP_MECHINT_KV_POSTTRAIN
	default "linear:1.0:0.1"
	help
	  Temperature schedule for the sigmoid relaxation of binary masks.
	  Format: <schedule>:<start_temp>:<end_temp>

	  Options:
	  - linear:1.0:0.1 - Linear decay from 1.0 to 0.1 (standard)
	  - constant:0.5 - Fixed temperature (simpler)
	  - exp:1.0:0.01 - Exponential decay (sharper transition)

	  Lower temperatures make masks more binary (sharper), while higher
	  temperatures keep them soft (more gradient flow during optimization).

config KNLP_MECHINT_VISUALIZE_WANDB
	bool "Enable W&B visualization for mechanistic analysis"
	depends on KNLP_MECHINT
	default y
	help
	  Log mechanistic interpretability results to Weights & Biases for
	  interactive visualization and comparison.

	  Logged artifacts include:
	  - Per-layer KV channel importance heatmaps
	  - Sparsity vs faithfulness curves
	  - Circuit topology graphs
	  - Attention pattern changes with/without pruning
	  - Layer-wise feature importance rankings

	  Visualizations are saved under the mechint/ namespace in W&B.

config KNLP_MECHINT_SAVE_MASKS
	bool "Save learned KV masks to disk"
	depends on KNLP_MECHINT_KV_POSTTRAIN
	default y
	help
	  Save the optimized KV feature masks to disk for later analysis or
	  deployment. Masks are saved as .pt files containing the binary mask
	  for each layer.

	  Saved masks can be used to:
	  - Deploy sparse models with reduced KV cache memory
	  - Compare circuits across different checkpoints
	  - Visualize feature importance distributions

config KNLP_MECHINT_OUTPUT_DIR
	string "Output directory for mechanistic analysis results"
	depends on KNLP_MECHINT
	default "mechint_analysis"
	help
	  Directory where mechanistic interpretability analysis results are
	  saved. This includes:
	  - Learned KV masks (.pt files)
	  - Importance score logs (.json)
	  - Visualization plots (.png)
	  - Circuit topology diagrams (.svg)
	  - Analysis summary reports (.md)

endif # KNLP_MECHINT

endmenu
```

## lenet5/Kconfig
```kconfig
# SPDX-License-Identifier: MIT
# LeNet-5 Model Configuration

config LENET5_NUM_CLASSES
	int "Number of output classes"
	default 10
	range 2 1000
	help
	  Number of output classes for LeNet-5. Default is 10 for MNIST.

# Simplified dataset selection - only MNIST for now
config LENET5_DATASET
	string
	default "mnist"
	help
	  Dataset for LeNet-5. Currently only MNIST is supported.

config LENET5_DATASET_MNIST
	bool
	default y
	help
	  LeNet-5 trained on MNIST dataset.

menu "LeNet-5 Adaptation Teaching Modes"

choice
	prompt "Adaptation mode"
	default LENET5_ADAPTATION_FULL
	help
	  Select how LeNet-5 is trained for pedagogical fine-tuning examples.
	  Same dataset and same LeNet-5 skeleton, three training philosophies.

config LENET5_ADAPTATION_FULL
	bool "Full fine-tuning"
	help
	  Train all LeNet-5 parameters. This is normal training/fine-tuning.

config LENET5_ADAPTATION_LORA
	bool "LoRA adapters"
	help
	  Freeze the base LeNet-5 model and train low-rank adapters on
	  selected fully-connected layers.

config LENET5_ADAPTATION_PREFIX
	bool "Image prefix / soft prompt"
	help
	  Freeze the base LeNet-5 model and train a learned image prefix.
	  This is a CNN analogy for prefix/prompt tuning, not transformer
	  KV prefix tuning.

endchoice

config LENET5_ADAPTATION_MODE
	string
	default "full" if LENET5_ADAPTATION_FULL
	default "lora" if LENET5_ADAPTATION_LORA
	default "prefix" if LENET5_ADAPTATION_PREFIX

config LENET5_BASE_CHECKPOINT
	string "Base checkpoint for PEFT modes"
	default ""
	help
	  Optional pretrained LeNet-5 checkpoint to load before freezing the
	  base model. Recommended for LoRA and prefix modes.

config LENET5_TRAIN_HEAD
	bool "Train final classifier head in PEFT modes"
	default y
	depends on LENET5_ADAPTATION_LORA || LENET5_ADAPTATION_PREFIX
	help
	  Also train fc2 in LoRA/prefix modes. This makes transfer examples
	  easier to understand and mirrors common practice where the task
	  head is adapted.

config LENET5_LORA_RANK
	int "LoRA rank"
	default 4
	range 1 64
	depends on LENET5_ADAPTATION_LORA
	help
	  Rank of the low-rank LoRA adapter.

config LENET5_LORA_ALPHA
	string "LoRA alpha"
	default "1.0"
	depends on LENET5_ADAPTATION_LORA
	help
	  Scaling factor for the LoRA update. Effective scale is alpha / rank.

config LENET5_PREFIX_ROWS
	int "Image prefix rows"
	default 4
	range 1 32
	depends on LENET5_ADAPTATION_PREFIX
	help
	  Number of top image rows used as the learned soft image prefix.

endmenu

menu "Image Tokenization (Experimental)"

config LENET5_ENABLE_TOKENIZER
	bool "Enable PCA-based image tokenization"
	default n
	help
	  Enable PCA-based tokenization for image inputs. Compresses
	  images into principal component space before feeding to model.

	  Benefits:
	  - Dimensionality reduction (784→64 for MNIST)
	  - Natural tiering hierarchy (by variance explained)
	  - Potential regularization effect

	  Requires fitting PCA on training data before use.

choice
	prompt "Tokenizer type"
	default LENET5_TOKENIZER_PCA
	depends on LENET5_ENABLE_TOKENIZER
	help
	  Choose tokenization strategy.

config LENET5_TOKENIZER_PCA
	bool "PCA tokenizer"
	help
	  Simple PCA-based tokenization. Projects images into
	  principal component space and tiers by variance explained.

	  Fast, simple, effective for MNIST.

config LENET5_TOKENIZER_SPLINE_PCA
	bool "Spline-PCA tokenizer"
	help
	  Advanced tokenization with spline trajectory compression.
	  Tracks how PCA components evolve during training and fits
	  cubic splines to trajectories.

	  Enables:
	  - Temporal tiering (by component update frequency)
	  - Trajectory compression (splines vs full history)
	  - Online learning (update control points)

	  Slower but more sophisticated than basic PCA.

endchoice

config LENET5_TOKENIZER_METHOD
	string
	default "none" if !LENET5_ENABLE_TOKENIZER
	default "pca" if LENET5_TOKENIZER_PCA
	default "spline-pca" if LENET5_TOKENIZER_SPLINE_PCA

config LENET5_PCA_COMPONENTS
	int "Number of PCA components"
	default 64
	range 8 784
	depends on LENET5_ENABLE_TOKENIZER
	help
	  Number of principal components to keep. For MNIST (784 dims):
	  - 32 components: ~90% variance, 24x compression
	  - 64 components: ~95% variance, 12x compression
	  - 128 components: ~98% variance, 6x compression

	  Lower values = more compression but potential quality loss.
	  Higher values = less compression but better quality.

config LENET5_PCA_WHITEN
	bool "Enable PCA whitening"
	default n
	depends on LENET5_ENABLE_TOKENIZER
	help
	  Normalize PCA components by their variance. Makes all
	  components have unit variance, which can help with
	  optimization but removes natural importance hierarchy.

	  Usually not needed for tiering (we want variance hierarchy).

config LENET5_SPLINE_CONTROL_POINTS
	int "Number of spline control points"
	default 8
	range 4 32
	depends on LENET5_TOKENIZER_SPLINE_PCA
	help
	  Number of control points for cubic spline fitting of
	  component trajectories. More points = better fit but
	  less compression.

	  For 10-epoch training:
	  - 4 points: High compression, smooth approximation
	  - 8 points: Balanced (recommended)
	  - 16 points: Low compression, detailed trajectory

config LENET5_TOKENIZER_SAVE_PATH
	string "Tokenizer save path"
	default "lenet5_tokenizer.pkl"
	depends on LENET5_ENABLE_TOKENIZER
	help
	  Path to save fitted tokenizer for later use.

endmenu

menu "Tokenization Test Matrix"

config TEST_TOKENIZER_BASELINE
	bool "Test baseline (no tokenization)"
	default n
	depends on TEST_MATRIX_MODE
	help
	  Include baseline test without tokenization in test matrix.
	  Uses full 784-dimensional MNIST images as input.

config TEST_TOKENIZER_PCA
	bool "Test PCA tokenization"
	default n
	depends on TEST_MATRIX_MODE
	help
	  Include PCA tokenization test in test matrix.
	  Uses spatial tiering by variance (784→64 dimensions).

config TEST_TOKENIZER_SPLINE_PCA
	bool "Test Spline-PCA tokenization"
	default n
	depends on TEST_MATRIX_MODE
	help
	  Include Spline-PCA tokenization test in test matrix.
	  Uses spatial + temporal tiering with trajectory tracking.

config TEST_TOKENIZER_METHODS
	string "Tokenization methods to test (comma-separated)"
	default ""
	depends on TEST_MATRIX_MODE
	help
	  Comma-separated list of tokenization methods to test.
	  Example: "none,pca,spline-pca"

	  This is the preferred way to specify tokenizer test matrix.
	  Individual flags (TEST_TOKENIZER_BASELINE, etc.) also work.

endmenu

menu "AdamWPrune Variants"

config LENET5_ADAMWPRUNE_VARIANT_BITTER0
	bool "Enable bitter0 variant (original state-based)"
	default y
	help
	  Original state-based pruning algorithm using Adam optimizer
	  states. This is the baseline state pruning method.

config LENET5_ADAMWPRUNE_VARIANT_BITTER7
	bool "Enable bitter7 variant (variance-based)"
	default n
	help
	  Variance-based pruning using Adam second moment (exp_avg_sq).
	  Achieves 15.6% better perplexity than magnitude baseline on
	  GPT-2 transformers (37.28 vs 44.15 PPL).

config LENET5_ADAMWPRUNE_DEFAULT_VARIANT
	string "Default AdamWPrune variant"
	default "bitter0" if LENET5_ADAMWPRUNE_VARIANT_BITTER0
	default "bitter7" if LENET5_ADAMWPRUNE_VARIANT_BITTER7

endmenu

menu "Training Parameters"

config LENET5_MAX_TIME
	int "Maximum training time in seconds (0 = no limit)"
	default 0
	help
	  Maximum wall-clock training time in seconds. Training stops
	  when this time limit is reached, regardless of epochs completed.

	  Set to 0 for no time limit (train for NUM_EPOCHS).

	  Time-based training enables fair "compute budget" comparisons
	  across different methods with varying iteration speeds. Graphs
	  use step counts for apples-to-apples comparison.

	  Example values:
	  - 120s (2 minutes): Quick CPU tests
	  - 240s (4 minutes): Standard CPU tests (2x typical 10-epoch runtime)
	  - 3600s (1 hour): Short GPU runs
	  - 7200s (2 hours): Standard GPU runs

endmenu
```
