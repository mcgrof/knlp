## research/code_reason/Kconfig
```kconfig
# Agentic Code Reasoning R&D harness (arXiv:2603.01896).
# Sourced from the top-level knlp Kconfig. Every experimental toggle lives
# here so nothing is buried in Python constants; the runner consumes a JSON
# artifact generated from .config, never hard-coded policy.

menu "Code Reasoning R&D"

config CODE_REASON
	bool "Enable Agentic Code Reasoning R&D harness"
	default n
	help
	  Master switch for the code-reasoning R&D vehicle. Off by default so
	  it never perturbs existing knlp defconfigs or `make check`.

config CODE_REASON_PAPER_REPRO
	bool "Reproduce Agentic Code Reasoning paper"
	depends on CODE_REASON
	default n
	help
	  Reproduce the paper setup only: static/execution-free verifier,
	  standard + semi-formal reasoning, no knlp addendums.

config CODE_REASON_AUGMENTED
	bool "Enable knlp augmented code-reasoning experiments"
	depends on CODE_REASON
	default n
	help
	  Layer the certificate addendums and A-vs-blB artifact generation on
	  top of the paper harness.

menu "Tasks"
	depends on CODE_REASON

config CODE_REASON_TASK_PATCH_EQUIV
	bool "Patch equivalence verification"
	default y

config CODE_REASON_TASK_FAULT_LOCALIZATION
	bool "Fault localization"
	default y

config CODE_REASON_TASK_CODE_QA
	bool "Code question answering"
	default y

endmenu

menu "Reasoning modes"
	depends on CODE_REASON

config CODE_REASON_MODE_STANDARD
	bool "Standard agentic reasoning"
	default y

config CODE_REASON_MODE_SEMIFORMAL
	bool "Semi-formal certificate reasoning"
	default y

endmenu

menu "Paper target models"
	depends on CODE_REASON

config CODE_REASON_MODEL_OPUS_4_5
	bool "Claude Opus 4.5"
	default y

config CODE_REASON_MODEL_SONNET_4_5
	bool "Claude Sonnet 4.5"
	default y

config CODE_REASON_MODEL_GEMINI_3_PRO_GRADER
	bool "Gemini 3 Pro grader / artifact source"
	default n

config CODE_REASON_MODEL_GPT_5_2_GRADER
	bool "GPT-5.2 grader"
	default n

endmenu

menu "Execution policy"
	depends on CODE_REASON

config CODE_REASON_NO_TARGET_REPO_EXECUTION
	bool "Forbid executing target repository code"
	default y

config CODE_REASON_NO_TARGET_TEST_EXECUTION
	bool "Forbid executing target repository tests"
	default y

config CODE_REASON_NO_TARGET_DEPENDENCY_INSTALL
	bool "Forbid installing target repository dependencies"
	default y

config CODE_REASON_NO_GIT_HISTORY
	bool "Forbid git history access during paper reproduction"
	default y

config CODE_REASON_ALLOW_STATIC_GIT_HISTORY_ADDENDUM
	bool "Allow git-history mining only as an explicit addendum"
	depends on CODE_REASON_AUGMENTED
	default n

endmenu

menu "Certificate addendums"
	depends on CODE_REASON_AUGMENTED

config CODE_REASON_ADDENDUMS
	bool "Enable addendum system"
	default n

config CODE_REASON_ADDENDUM_A_VS_BLB
	bool "Emit A-vs-blB comparison artifacts"
	depends on CODE_REASON_ADDENDUMS

config CODE_REASON_ADDENDUM_AST_RUNTIME
	bool "Emit static AST/runtime-shape assessment for affected files"
	depends on CODE_REASON_ADDENDUMS

config CODE_REASON_ADDENDUM_COLLATERAL_EVOLUTION
	bool "Mine collateral evolution evidence from code history"
	depends on CODE_REASON_ADDENDUMS
	select CODE_REASON_ALLOW_STATIC_GIT_HISTORY_ADDENDUM

config CODE_REASON_ADDENDUM_COCCINELLE
	bool "Use Coccinelle / SmPL semantic patch analysis when compatible"
	depends on CODE_REASON_ADDENDUMS

config CODE_REASON_ADDENDUM_COCCINELLE_AUTO_DISABLE_IF_UNSUPPORTED
	bool "Auto-disable Coccinelle addendum outside compatible C-family repos"
	depends on CODE_REASON_ADDENDUM_COCCINELLE
	default y

config CODE_REASON_ADDENDUM_SEMANTIC_REWRITE
	bool "Use language-adaptive semantic rewrite addendum"
	depends on CODE_REASON_ADDENDUMS

config CODE_REASON_ADDENDUM_LANGUAGE_ADAPTIVE
	bool "Select addendum implementation based on repository language"
	depends on CODE_REASON_ADDENDUMS

endmenu

menu "Artifacts"
	depends on CODE_REASON

config CODE_REASON_RECORD_TRANSCRIPTS
	bool "Record agent transcripts"
	default y

config CODE_REASON_RECORD_CERTIFICATES
	bool "Record semi-formal certificates"
	default y

config CODE_REASON_RECORD_ADDENDUMS
	bool "Record addendum outputs"
	default n

config CODE_REASON_RECORD_TOKEN_COSTS
	bool "Record token and cost accounting"
	default y

config CODE_REASON_RECORD_AB_ARTIFACTS
	bool "Record paired A/B artifacts"
	default n

endmenu

endmenu
```

## resnet18/Kconfig
```kconfig
# SPDX-License-Identifier: MIT
# ResNet-18 Model Configuration

config RESNET18_NUM_CLASSES
	int "Number of output classes"
	default 10
	range 2 1000
	help
	  Number of output classes for ResNet-18.
	  Default is 10 for CIFAR-10.
	  Use 100 for CIFAR-100, 1000 for ImageNet.

choice
	prompt "Dataset"
	default RESNET18_DATASET_CIFAR10
	help
	  Select the dataset for training ResNet-18.

config RESNET18_DATASET_CIFAR10
	bool "CIFAR-10"
	help
	  CIFAR-10 dataset: 32x32 color images in 10 classes.
	  60,000 images total (50,000 training, 10,000 test).

config RESNET18_DATASET_CIFAR100
	bool "CIFAR-100"
	help
	  CIFAR-100 dataset: 32x32 color images in 100 classes.
	  60,000 images total (50,000 training, 10,000 test).

endchoice

config RESNET18_DATASET
	string
	default "cifar10" if RESNET18_DATASET_CIFAR10
	default "cifar100" if RESNET18_DATASET_CIFAR100

# ResNet-18 specific training parameters
config RESNET18_EPOCHS
	int "Number of training epochs"
	default 100
	range 1 300
	help
	  Number of epochs to train ResNet-18.
	  Default is 100 for CIFAR-10.
	  Typically needs 100-200 epochs for good convergence.

config RESNET18_BATCH_SIZE
	int "Batch size for ResNet-18"
	default 128
	range 16 512
	help
	  Batch size for ResNet-18 training.
	  Default is 128. Reduce if GPU memory is limited.

config RESNET18_BASE_LR
	string "Base learning rate"
	default "0.1"
	help
	  Base learning rate for ResNet-18.
	  Default is 0.1 for SGD, will be scaled for Adam-based optimizers.

config RESNET18_USE_AUGMENTATION
	bool "Use data augmentation"
	default y
	help
	  Enable data augmentation for training.
	  Includes random cropping and horizontal flipping.

config RESNET18_USE_COSINE_SCHEDULE
	bool "Use cosine learning rate schedule"
	default y
	help
	  Use cosine annealing for learning rate scheduling.
	  Recommended for ResNet training on CIFAR.

config RESNET18_MAX_TIME
	int "Maximum training time in seconds (0 = no limit)"
	default 0
	help
	  Maximum wall-clock training time in seconds. Training stops
	  when this time limit is reached, regardless of epochs completed.

	  Set to 0 for no time limit (train for RESNET18_EPOCHS).

	  Time-based training enables fair "compute budget" comparisons
	  across different methods with varying iteration speeds.

menu "AdamWPrune Variants"

config RESNET18_ADAMWPRUNE_VARIANT_BITTER0
	bool "Enable bitter0 variant (original state-based)"
	default y
	help
	  Original state-based pruning algorithm using Adam optimizer
	  states. This is the baseline state pruning method.

config RESNET18_ADAMWPRUNE_VARIANT_BITTER7
	bool "Enable bitter7 variant (variance-based)"
	default n
	help
	  Variance-based pruning using Adam second moment (exp_avg_sq).
	  Achieves 15.6% better perplexity than magnitude baseline on
	  GPT-2 transformers (37.28 vs 44.15 PPL).

config RESNET18_ADAMWPRUNE_DEFAULT_VARIANT
	string "Default AdamWPrune variant"
	default "bitter0" if RESNET18_ADAMWPRUNE_VARIANT_BITTER0
	default "bitter7" if RESNET18_ADAMWPRUNE_VARIANT_BITTER7

endmenu
```

## resnet50/Kconfig
```kconfig
# SPDX-License-Identifier: MIT

menu "ResNet-50 Configuration"
	depends on MODEL_RESNET50

config RESNET50_DATASET
	string "Dataset for ResNet-50"
	default "cifar100"
	help
	  Dataset to use for training ResNet-50.
	  Options: cifar100, imagenet
	  
	  cifar100: CIFAR-100 dataset (100 classes, 32x32 images resized to 224x224)
	  imagenet: ImageNet dataset (1000 classes, 224x224 images)

config RESNET50_DATA_DIR
	string "Data directory path"
	default "./data"
	help
	  Path to the dataset directory.
	  For ImageNet, this should contain 'train' and 'val' subdirectories.

config RESNET50_BATCH_SIZE
	int "Batch size"
	default 128 if RESNET50_DATASET = "cifar100"
	default 256 if RESNET50_DATASET = "imagenet"
	help
	  Batch size for training.
	  Recommended: 128 for CIFAR-100, 256 for ImageNet (adjust based on GPU memory)

config RESNET50_LEARNING_RATE
	string "Learning rate"
	default "0.001" if OPTIMIZER_ADAMWPRUNE
	default "0.1" if OPTIMIZER_SGD
	help
	  Initial learning rate for training.

config RESNET50_EPOCHS
	int "Number of epochs"
	default 100 if RESNET50_DATASET = "cifar100"
	default 90 if RESNET50_DATASET = "imagenet"
	help
	  Number of training epochs.

config RESNET50_NUM_WORKERS
	int "Number of data loading workers"
	default 4
	help
	  Number of subprocesses for data loading.

config RESNET50_LOG_INTERVAL
	int "Logging interval (batches)"
	default 10
	help
	  How many batches to wait before logging training status.

config RESNET50_SAVE_MODEL
	bool "Save best model"
	default y
	help
	  Save the model with the best validation accuracy.

config RESNET50_MONITOR_GPU
	bool "Monitor GPU usage"
	default y
	help
	  Enable GPU memory and utilization monitoring during training.

menu "Image Tokenization (Experimental)"

config RESNET50_ENABLE_TOKENIZER
	bool "Enable PCA-based image tokenization"
	default n
	help
	  Enable PCA-based tokenization for image inputs. Compresses
	  images into principal component space before feeding to model.

	  Benefits:
	  - Dimensionality reduction (3072→256 for CIFAR-100)
	  - Natural tiering hierarchy (by variance explained)
	  - Potential regularization effect

	  Requires fitting PCA on training data before use.

choice
	prompt "Tokenizer type"
	default RESNET50_TOKENIZER_PCA
	depends on RESNET50_ENABLE_TOKENIZER
	help
	  Choose tokenization strategy.

config RESNET50_TOKENIZER_PCA
	bool "PCA tokenizer"
	help
	  Simple PCA-based tokenization. Projects images into
	  principal component space and tiers by variance explained.

	  Fast, simple, effective for image classification.

config RESNET50_TOKENIZER_SPLINE_PCA
	bool "Spline-PCA tokenizer"
	help
	  Advanced tokenization with spline trajectory compression.
	  Tracks how PCA components evolve during training and fits
	  cubic splines to trajectories.

	  Enables:
	  - Temporal tiering (by component update frequency)
	  - Trajectory compression (splines vs full history)
	  - Online learning (update control points)

	  Slower but more sophisticated than basic PCA.

endchoice

config RESNET50_TOKENIZER_METHOD
	string
	default "none" if !RESNET50_ENABLE_TOKENIZER
	default "pca" if RESNET50_TOKENIZER_PCA
	default "spline-pca" if RESNET50_TOKENIZER_SPLINE_PCA

config RESNET50_PCA_COMPONENTS
	int "Number of PCA components"
	default 256
	range 32 3072
	depends on RESNET50_ENABLE_TOKENIZER
	help
	  Number of principal components to keep. For CIFAR-100 (3072 dims):
	  - 128 components: High compression, ~12x reduction
	  - 256 components: Medium compression, ~12x reduction
	  - 512 components: Low compression, ~6x reduction

	  Lower values = more compression but potential quality loss.
	  Higher values = less compression but better quality.

config RESNET50_PCA_WHITEN
	bool "Enable PCA whitening"
	default n
	depends on RESNET50_ENABLE_TOKENIZER
	help
	  Normalize PCA components by their variance. Makes all
	  components have unit variance, which can help with
	  optimization but removes natural importance hierarchy.

	  Usually not needed for tiering (we want variance hierarchy).

config RESNET50_SPLINE_CONTROL_POINTS
	int "Number of spline control points"
	default 8
	range 4 32
	depends on RESNET50_TOKENIZER_SPLINE_PCA
	help
	  Number of control points for cubic spline fitting of
	  component trajectories. More points = better fit but
	  less compression.

	  For typical training:
	  - 4 points: High compression, smooth approximation
	  - 8 points: Balanced (recommended)
	  - 16 points: Low compression, detailed trajectory

config RESNET50_TOKENIZER_SAVE_PATH
	string "Tokenizer save path"
	default "resnet50_tokenizer.pkl"
	depends on RESNET50_ENABLE_TOKENIZER
	help
	  Path to save fitted tokenizer for later use.

endmenu

menu "Tokenization Test Matrix"

config TEST_TOKENIZER_BASELINE_RESNET50
	bool "Test baseline (no tokenization)"
	default n
	depends on TEST_MATRIX_MODE && MODEL_RESNET50
	help
	  Include baseline test without tokenization in test matrix.
	  Uses full 3072-dimensional CIFAR-100 images as input.

config TEST_TOKENIZER_PCA_RESNET50
	bool "Test PCA tokenization"
	default n
	depends on TEST_MATRIX_MODE && MODEL_RESNET50
	help
	  Include PCA tokenization test in test matrix.
	  Uses spatial tiering by variance (3072→256 dimensions).

config TEST_TOKENIZER_SPLINE_PCA_RESNET50
	bool "Test Spline-PCA tokenization"
	default n
	depends on TEST_MATRIX_MODE && MODEL_RESNET50
	help
	  Include Spline-PCA tokenization test in test matrix.
	  Uses spatial + temporal tiering with trajectory tracking.

endmenu

config RESNET50_PRUNING_START_EPOCH
	int "Pruning start epoch"
	default 10
	depends on !PRUNING_NONE
	help
	  Epoch to start pruning (gradual ramp-up).

config RESNET50_PRUNING_END_EPOCH
	int "Pruning end epoch"
	default 80 if RESNET50_DATASET = "cifar100"
	default 70 if RESNET50_DATASET = "imagenet"
	depends on !PRUNING_NONE
	help
	  Epoch to reach target sparsity.

config RESNET50_MAX_TIME
	int "Maximum training time in seconds (0 = no limit)"
	default 0
	help
	  Maximum wall-clock training time in seconds. Training stops
	  when this time limit is reached, regardless of epochs completed.

	  Set to 0 for no time limit (train for RESNET50_EPOCHS).

	  Time-based training enables fair "compute budget" comparisons
	  across different methods with varying iteration speeds.

menu "AdamWPrune Variants"

config RESNET50_ADAMWPRUNE_VARIANT_BITTER0
	bool "Enable bitter0 variant (original state-based)"
	default y
	help
	  Original state-based pruning algorithm using Adam optimizer
	  states. This is the baseline state pruning method.

config RESNET50_ADAMWPRUNE_VARIANT_BITTER7
	bool "Enable bitter7 variant (variance-based)"
	default n
	help
	  Variance-based pruning using Adam second moment (exp_avg_sq).
	  Achieves 15.6% better perplexity than magnitude baseline on
	  GPT-2 transformers (37.28 vs 44.15 PPL).

config RESNET50_ADAMWPRUNE_DEFAULT_VARIANT
	string "Default AdamWPrune variant"
	default "bitter0" if RESNET50_ADAMWPRUNE_VARIANT_BITTER0
	default "bitter7" if RESNET50_ADAMWPRUNE_VARIANT_BITTER7

endmenu

endmenu
```
