## gnn/Kconfig
```kconfig
# SPDX-License-Identifier: MIT
# GNN (Graph Neural Network) Model Configuration
#
# Page-Aware Mini-Batch Training for GNN node classification.
# Reduces read amplification by 10x while achieving superior metrics
# compared to traditional neighbor sampling.
#
# Supports fraud detection (DGraphFin, YelpChi, Amazon, Elliptic)
# and general node classification (ogbn-products, ogbn-proteins).

menu "GNN Configuration"

config GNN_FRAUD
	bool "Enable GNN Training"
	default y if MODEL_GNN
	default n
	help
	  Enable GNN training with page-aware mini-batch sampling.
	  Supports fraud detection datasets (DGraphFin, YelpChi, Amazon,
	  Elliptic) and general node classification (ogbn-products).

if GNN_FRAUD

choice
	prompt "Dataset"
	default GNN_FRAUD_DATASET_DGRAPHFIN
	help
	  Select the dataset for GNN training.

config GNN_FRAUD_DATASET_DGRAPHFIN
	bool "DGraphFin (Real Financial)"
	help
	  DGraphFin: 3.7M nodes, 4.3M edges, 17 features.
	  Real financial fraud network from Ant Group.
	  0.42% fraud rate (extreme class imbalance).

config GNN_FRAUD_DATASET_YELPCHI
	bool "YelpChi (Review Spam)"
	help
	  YelpChi: 45K nodes, review spam detection.
	  Reviews connected by reviewer/product/rating relations.
	  Binary classification (spam/legitimate).

config GNN_FRAUD_DATASET_AMAZON
	bool "Amazon (Product Fraud)"
	help
	  Amazon: 11K nodes, product fraud detection.
	  Users connected by product/star/category relations.
	  Binary classification (fraud/legitimate).

config GNN_FRAUD_DATASET_ELLIPTIC
	bool "Elliptic (Bitcoin Fraud)"
	help
	  Elliptic: 203K nodes, Bitcoin transaction fraud.
	  Temporal transaction graph with partial labels.
	  Binary classification (illicit/licit).

config GNN_FRAUD_DATASET_OGBN_PRODUCTS
	bool "ogbn-products (Node Classification)"
	help
	  ogbn-products: 2.4M nodes, product classification.
	  Amazon co-purchasing network from OGB benchmark.
	  47 product categories.

config GNN_FRAUD_DATASET_OGBN_PROTEINS
	bool "ogbn-proteins (Protein Function)"
	help
	  ogbn-proteins: 132K nodes, protein function prediction.
	  Protein-protein association network from OGB benchmark.
	  112 labels (multi-label classification).

config GNN_FRAUD_DATASET_SYNTHETIC
	bool "Synthetic Transaction Graph"
	help
	  Generate synthetic transaction graph with configurable
	  size and fraud rate using transaction-motif generator.

endchoice

config GNN_FRAUD_DATASET
	string
	default "dgraphfin" if GNN_FRAUD_DATASET_DGRAPHFIN
	default "yelpchi" if GNN_FRAUD_DATASET_YELPCHI
	default "amazon" if GNN_FRAUD_DATASET_AMAZON
	default "elliptic" if GNN_FRAUD_DATASET_ELLIPTIC
	default "ogbn-products" if GNN_FRAUD_DATASET_OGBN_PRODUCTS
	default "ogbn-proteins" if GNN_FRAUD_DATASET_OGBN_PROTEINS
	default "synthetic" if GNN_FRAUD_DATASET_SYNTHETIC

config GNN_FRAUD_DATA_DIR
	string "Data directory"
	default "."
	help
	  Directory containing dataset files (e.g., dgraphfin.npz).
	  Default is current directory.

choice
	prompt "Training Method"
	default GNN_FRAUD_METHOD_PAGEAWARE
	help
	  Select the training method for GNN fraud detection.

config GNN_FRAUD_METHOD_NEIGHBORLOADER
	bool "NeighborLoader (Baseline)"
	help
	  Traditional K-hop neighbor sampling via PyG NeighborLoader.
	  High read amplification (~58x) but standard approach.

config GNN_FRAUD_METHOD_PAGEAWARE
	bool "Page-Aware Mini-Batch"
	help
	  Memory-locality-optimized training using METIS+BFS graph
	  layout. Processes entire memory pages as mini-batches.
	  Low read amplification (~5x) with better fraud metrics.

config GNN_FRAUD_METHOD_BOTH
	bool "Both (Comparison)"
	help
	  Run both methods for comparison. Each runs for the same
	  wall-clock time for fair evaluation.

endchoice

config GNN_FRAUD_METHOD
	string
	default "neighborloader" if GNN_FRAUD_METHOD_NEIGHBORLOADER
	default "pageaware" if GNN_FRAUD_METHOD_PAGEAWARE
	default "both" if GNN_FRAUD_METHOD_BOTH

config GNN_FRAUD_TIME_LIMIT
	int "Training time limit (seconds)"
	default 3600
	range 60 86400
	help
	  Wall-clock time limit for training each method.
	  Default is 3600 seconds (1 hour).

config GNN_FRAUD_HIDDEN_CHANNELS
	int "Hidden channels in GraphSAGE"
	default 128
	range 32 512
	help
	  Number of hidden channels in the GraphSAGE model.
	  Default is 128.

config GNN_FRAUD_LEARNING_RATE
	string "Learning rate"
	default "0.003"
	help
	  Learning rate for Adam optimizer.

config GNN_FRAUD_WEIGHT_DECAY_BASELINE
	string "Weight decay for baseline (NeighborLoader)"
	default "5e-7"
	help
	  Weight decay for NeighborLoader baseline training.
	  Default matches original DGraphFin benchmark.

config GNN_FRAUD_WEIGHT_DECAY_PAGEAWARE
	string "Weight decay for page-aware training"
	default "5e-7"
	help
	  Weight decay for page-aware mini-batch training.
	  Lower values may help due to implicit regularization
	  from correlated batches.

menu "NeighborLoader Configuration"
	depends on GNN_FRAUD_METHOD_NEIGHBORLOADER || GNN_FRAUD_METHOD_BOTH

config GNN_FRAUD_NUM_NEIGHBORS
	string "Fanout per hop (comma-separated)"
	default "10,5"
	help
	  Number of neighbors to sample at each hop.
	  Default [10, 5] samples 10 at hop 1, 5 at hop 2.

config GNN_FRAUD_BATCH_SIZE
	int "Batch size (seed nodes)"
	default 1024
	range 128 8192
	help
	  Number of seed nodes per mini-batch for NeighborLoader.

endmenu

menu "Page-Aware Configuration"
	depends on GNN_FRAUD_METHOD_PAGEAWARE || GNN_FRAUD_METHOD_BOTH

config GNN_FRAUD_PAGES_PER_BATCH
	int "Pages per batch"
	default 32
	range 8 128
	help
	  Number of 4KB pages to include per mini-batch.
	  Each page contains ~60 nodes.

config GNN_FRAUD_BOUNDARY_BUDGET
	string "Boundary expansion budget"
	default "0.0"
	help
	  Fraction of extra nodes to add from 1-hop boundary.
	  Default 0 (pure intra-page) is fastest AND achieves best F1.
	  Boundary expansion adds overhead without quality benefit.

config GNN_FRAUD_LAYOUT_PATH
	string "Layout file path"
	default "layout_metis_bfs.npz"
	help
	  Path to pre-computed METIS+BFS layout file.
	  Build with: python scripts/build_graph_layout.py

endmenu

menu "Synthetic Graph Generator"
	depends on GNN_FRAUD_DATASET_SYNTHETIC

config GNN_FRAUD_SYNTH_ACCOUNTS
	int "Number of account nodes"
	default 25000
	range 1000 10000000
	help
	  Number of account nodes in synthetic graph.

config GNN_FRAUD_SYNTH_MERCHANTS
	int "Number of merchant nodes"
	default 15000
	range 500 5000000
	help
	  Number of merchant nodes in synthetic graph.

config GNN_FRAUD_SYNTH_DEVICES
	int "Number of device nodes"
	default 10000
	range 500 5000000
	help
	  Number of device nodes in synthetic graph.

config GNN_FRAUD_SYNTH_COMMUNITIES
	int "Number of communities"
	default 100
	range 10 10000
	help
	  Number of communities for generating graph structure.

config GNN_FRAUD_SYNTH_FRAUD_RATE
	string "Fraud rate"
	default "0.02"
	help
	  Fraction of accounts labeled as fraudulent.

endmenu

config GNN_FRAUD_USE_WANDB
	bool "Enable W&B logging"
	default y
	help
	  Log training metrics to Weights & Biases.

config GNN_FRAUD_WANDB_PROJECT
	string "W&B project name"
	default "gnn-fraud-detection"
	depends on GNN_FRAUD_USE_WANDB
	help
	  Weights & Biases project name for experiment tracking.

endif # GNN_FRAUD

endmenu
```
