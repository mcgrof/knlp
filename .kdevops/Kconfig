## Kconfig.decode
```kconfig
# SPDX-License-Identifier: MIT
# Configuration for paper-memory-decode reproduction profiles.
#
# Selecting one of the decode-* defconfigs sets these values.  After
# defconfig selection, plain `make` runs the configured profile via
# Makefile.decode.

menu "Paper-memory-decode reproduction"

config KNLP_REPRODUCE_DECODE
	bool "Enable paper-memory-decode reproduction profile"
	default n
	help
	  Set by defconfig-decode, defconfig-decode-sat, and
	  defconfig-decode-full.  When set, plain `make` runs the
	  configured reproduction profile.

if KNLP_REPRODUCE_DECODE

config KNLP_REPRODUCE_PROFILE
	string "Reproduction profile name"
	default "decode"
	help
	  One of: decode, decode-sat, decode-full.  Drives stage
	  selection in tools/reproduce/paper_memory_decode/run.py.

config KNLP_WORKTREE_ROOT
	string "Parent directory for cloned companion repos"
	default ".."
	help
	  Companion repos (vllm, flashinfer, lmcache,
	  paper-memory-decode) are cloned into this directory.
	  Default is the parent of the knlp checkout.

config KNLP_RESULTS_ROOT
	string "Results directory"
	default "./results/decode"

config KNLP_BUILD_ROOT
	string "Build/cache directory"
	default "./build/decode"

# ── Companion repos ────────────────────────────────────────────

config KNLP_VLLM_REPO
	string "vLLM repo URL"
	default "https://github.com/mcgrof/vllm.git"

config KNLP_VLLM_REF
	string "vLLM git ref (branch, tag, or commit)"
	default "asymmetric-kv-plumbing"

config KNLP_VLLM_DIR
	string "vLLM clone directory (relative to WORKTREE_ROOT)"
	default "vllm"

config KNLP_FLASHINFER_REPO
	string "FlashInfer repo URL"
	default "https://github.com/mcgrof/flashinfer.git"

config KNLP_FLASHINFER_REF
	string "FlashInfer git ref"
	default "asym-prefill-refactor-stage"

config KNLP_FLASHINFER_DIR
	string "FlashInfer clone directory"
	default "flashinfer"

config KNLP_LMCACHE_REPO
	string "LMCache repo URL"
	default "https://github.com/mcgrof/LMCache.git"

config KNLP_LMCACHE_REF
	string "LMCache git ref"
	default "asymmetric-kv-codec"

config KNLP_LMCACHE_DIR
	string "LMCache clone directory"
	default "lmcache"

config KNLP_PAPER_REPO
	string "Paper repo URL"
	default "https://github.com/mcgrof/paper-memory-decode.git"

config KNLP_PAPER_REF
	string "Paper git ref"
	default "main"

config KNLP_PAPER_DIR
	string "Paper clone directory"
	default "paper-memory-decode"

# ── Models / datasets ──────────────────────────────────────────

config KNLP_MODEL_QWEN25_7B
	string "Qwen2.5-7B HF model id"
	default "Qwen/Qwen2.5-7B-Instruct"

config KNLP_DATASET_WIKITEXT
	string "WikiText dataset name"
	default "wikitext"

config KNLP_DATASET_GSM8K
	string "GSM8K dataset name"
	default "gsm8k"

# ── Telemetry ──────────────────────────────────────────────────

config KNLP_ENABLE_WANDB
	bool "Mirror metrics to Weights & Biases"
	default n
	help
	  When enabled, metrics also stream to W&B.  Local JSONL is
	  always canonical.  Reads WANDB_API_KEY from environment.

config KNLP_WANDB_PROJECT
	string "W&B project name"
	depends on KNLP_ENABLE_WANDB
	default "knlp-memory-decode"

config KNLP_WANDB_ENTITY
	string "W&B entity (leave blank for default)"
	depends on KNLP_ENABLE_WANDB
	default ""

config KNLP_WANDB_MODE
	string "W&B mode (online, offline, disabled)"
	depends on KNLP_ENABLE_WANDB
	default "online"

config KNLP_ENABLE_TRACKERIO
	bool "Mirror metrics to trackerio"
	default n

config KNLP_TRACKERIO_PROJECT
	string "trackerio project name"
	depends on KNLP_ENABLE_TRACKERIO
	default "knlp-memory-decode"

config KNLP_TRACKERIO_URL
	string "trackerio base URL"
	depends on KNLP_ENABLE_TRACKERIO
	default ""

# ── Run policy ─────────────────────────────────────────────────

config KNLP_UPLOAD_ARTIFACTS
	bool "Upload artifacts (manifest, plots, report) to W&B/trackerio"
	default n
	depends on KNLP_ENABLE_WANDB || KNLP_ENABLE_TRACKERIO

config KNLP_ALLOW_HARDWARE_SKIPS
	bool "Allow stages to skip when required hardware is missing"
	default y
	help
	  When set, stages emit a structured skip entry instead of
	  failing when their required hardware (e.g. B200, MI300X) is
	  not present.  Skips are recorded in skips.json and surfaced
	  in the run report.

config KNLP_FAIL_ON_DIRTY_GIT
	bool "Fail if any companion repo has uncommitted changes"
	default y

config KNLP_REQUIRE_PINNED_REFS
	bool "Require all companion-repo refs to be pinned commit SHAs"
	default n
	help
	  When set, refs must be 40-char commit SHAs (not branch names).
	  Useful for archival reproduction; relax for development.

config KNLP_PARALLEL_GPUS
	string "GPU parallelism (auto, off, or fixed integer)"
	default "auto"
	help
	  When the host has multiple GPUs, the orchestrator can shard
	  independent stages across them with CUDA_VISIBLE_DEVICES.
	  This is embarrassingly parallel; not tensor parallel.

config KNLP_MAX_PARALLEL_GPU_JOBS
	int "Maximum concurrent GPU jobs"
	default 8

endif # KNLP_REPRODUCE_DECODE

endmenu
```

## Kconfig.fdec
```kconfig
# SPDX-License-Identifier: MIT
# fdec -- fight-decode brick composition. See docs/fdec.md.
#
# Names a point in the decode-optimization compatibility matrix: a model plus a
# set of enabled bricks. The executor is scripts/fdec_matrix.py (algorithmic
# dimension, any GPU) and the serving-stack profiles (kernel/throughput, CUDA).

menu "Fight-decode (fdec) brick composition"

config FDEC_ENABLE
	bool "Enable fdec brick-composition regime"
	default n
	help
	  Compose bleeding-edge decode optimizations and verify they compose
	  without mismatch. See docs/fdec.md. Selected by defconfig-fdec.

if FDEC_ENABLE

config FDEC_MODEL
	string "Model HF id (dense/GQA) or linear-attention checkpoint"
	default "Qwen/Qwen2.5-7B-Instruct"

config FDEC_ASYM_KV
	bool "Brick: asymmetric K16/V8 KV quantization"
	default y
	help
	  Keep keys at native precision, quantize values to FP8. KV-pool brick.
	  Proven (1.38x decode, prefix-cache-safe). N/A for linear-attention models.

config FDEC_LMHEAD_IDBLOCK
	bool "Brick: LM-head idblock routing"
	default y
	help
	  Certified-lossless LM-head decode routing. LM-head-pool brick.

config FDEC_FIM_WEIGHT_QUANT
	bool "Brick: FIM-guided weight quantization"
	default n
	help
	  Fisher-sensitivity-guided weight quantization. Weights-pool brick.
	  Stack-integration open (D5: GGUF/llama.cpp vs vLLM-native weight quant).

config FDEC_LINEAR_ATTN
	bool "Brick: linear-attention model class"
	default n
	help
	  Use a linear-attention model (Gated DeltaNet / Trellis / Mamba2 / RWKV).
	  Removes the KV pool -- the structural escape from the dense-attention
	  offload bandwidth bound. Asymmetric KV quant does not apply.

endif # FDEC_ENABLE

endmenu
```

## Kconfig.kri_tierkv
```kconfig
# SPDX-License-Identifier: MIT
# KRI-TierKV: KRI-guided tiered KV-cache eviction and sparse retrieval.
# Inspired by TTKV (arXiv:2604.19769); not a clone -- the tiering policy is
# KRI-D-sum. FP8 here is fake/storage quantization only (no native FP8 on A100).

config KNLP_KRI_TIERKV
	bool "KRI-TierKV: KRI-guided tiered KV cache eviction and sparse retrieval"
	default n

config KNLP_KRI_TIERKV_EMU
	bool "KRI-TierKV emulation mode"
	depends on KNLP_KRI_TIERKV
	default y

config KNLP_KRI_TIERKV_KRI_D_SUM
	bool "Use KRI-D-sum as primary block selector"
	depends on KNLP_KRI_TIERKV
	default y

config KNLP_KRI_TIERKV_ASYM_QUANT
	bool "Enable asymmetric KV fake quantization"
	depends on KNLP_KRI_TIERKV
	default n

config KNLP_KRI_TIERKV_V_ONLY
	bool "Enable V-only quantization policy, K remains fp16/bf16"
	depends on KNLP_KRI_TIERKV_ASYM_QUANT
	default y

config KNLP_KRI_TIERKV_HTML_REPORT
	bool "Generate HTML report for KRI-TierKV experiments"
	depends on KNLP_KRI_TIERKV
	default y
```
