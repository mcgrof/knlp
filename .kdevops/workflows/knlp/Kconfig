## Kconfig.kmesh
```kconfig
# SPDX-License-Identifier: MIT
menu "Exact-prefix reasoning forks"

config KNLP_REPRODUCE_KMESH_REGISTERED
	bool "Replay serial model repair from registered native spans"
	default n
	help
	  Use the pinned Qwen workload and separate-process CPU-L1 span service.
	  Keep reference lookup/storage as scheduling controls and feed real
	  model repair from registered restores. This duplicates storage and
	  does not measure serving latency or DMA-BUF performance.

if KNLP_REPRODUCE_KMESH_REGISTERED

config KNLP_KMESH_REGISTERED_ROUTE
	string "Model input route: reference or registered"
	default "registered"

config KNLP_KMESH_REGISTERED_VLLM_SOURCE
	string "Clean pinned vLLM checkout"
	default ""

config KNLP_KMESH_REGISTERED_LMCACHE_SOURCE
	string "Clean pinned LMCache checkout and matching native extensions"
	default ""

config KNLP_KMESH_REGISTERED_WHEEL_PACKAGE
	string "Pinned vLLM wheel package directory"
	default ""

config KNLP_KMESH_REGISTERED_MODEL_DIR
	string "Pinned local Qwen snapshot"
	default ""

config KNLP_KMESH_REGISTERED_TRACE
	string "Frozen synthetic TokenDance trace.jsonl"
	default ""

config KNLP_KMESH_REGISTERED_MANIFEST
	string "Frozen trace manifest.json"
	default ""

config KNLP_KMESH_REGISTERED_OUTPUT
	string "Fresh capture directory outside source checkouts"
	default ""

config KNLP_KMESH_REGISTERED_REFERENCE
	string "Independently verified serial-reference artifacts directory"
	default ""

config KNLP_KMESH_REGISTERED_VERIFICATION
	string "Independent reference verified.json"
	default ""

config KNLP_KMESH_REGISTERED_ORDINARY_RESULT
	string "Historical ordinary-model result.json for failure controls"
	default ""

config KNLP_KMESH_REGISTERED_ORDINARY_VERIFICATION
	string "Independent historical verification binding that ordinary result"
	default ""

endif

config KNLP_REPRODUCE_KMESH_CONTRACTS
	bool "Qualify CPU ownership, sessions and registered-context lifetime"
	default n
	help
	  Run the pinned LMCache CPU ownership controls and transport suites.
	  Require every selected case and test phase to execute successfully.
	  GPUs are hidden. This does not qualify KMesh serving or device I/O.

if KNLP_REPRODUCE_KMESH_CONTRACTS

config KNLP_KMESH_CONTRACTS_PROFILE
	string "CPU source profile"
	default "contexts"
	help
	  Keep the context/registered-state gates or select retained rotary
	  transfers, or ordered-registration. Each profile pins its own source
	  and required cases. Ordered registration keeps serving disabled.
	  Select owned-raw-copy for partial raw import and cleanup lifetime.
	  Select managed-raw-context for checked context admission controls.
	  Select managed-raw-service for bounded service ownership controls.
	  Select native-spans for checked admission and host-buffer lifetimes.
	  Select interior-spans for arbitrary source-position admission.
	  Select registered-inputs for serial source/fallback and fused-layout controls.
	  Select registered-arenas for eager pinned and GPU source prerequisites.

config KNLP_KMESH_CONTRACTS_SOURCE
	string "Clean pinned LMCache source with its shared native extension"
	default ""

config KNLP_KMESH_CONTRACTS_VLLM_SOURCE
	string "Clean pinned vLLM checkout when the CPU profile requires it"
	default ""

config KNLP_KMESH_CONTRACTS_OUTPUT
	string "Fresh result directory outside all source checkouts"
	default ""

endif

config KNLP_REPRODUCE_KMESH_NATIVE
	bool "Qualify native paged-cache layouts and position recovery"
	default n
	help
	  Check the pinned LMCache executor and registered retrieve handlers
	  with synthetic BF16 payloads. Require every selected test to run;
	  skips cannot qualify a native result. No serving speed is measured.

if KNLP_REPRODUCE_KMESH_NATIVE

config KNLP_KMESH_NATIVE_PROFILE
	string "Native qualification profile"
	default "paged-cache"
	help
	  Select native paged-cache rotation or separate-process registered
	  tensor copying, or ordered-registration through public RPC servers.
	  Select raw-ipc-lifetime for checked raw mapping release and aliases.
	  Select raw-ipc-outcomes for native uncertainty and receiver counters.
	  Select owned-raw-copy for retained raw rotary import and cleanup.
	  Select managed-raw-context for checked CUDA context retirement.
	  Select managed-raw-service for public raw control and release RPCs.
	  Select native-spans for native store, shifted restore and physical drain.
	  Select interior-spans for multilayer NHD/HND interior-source gathers.
	  Select registered-inputs for fused K/V, native layer inputs and retirement.
	  Select registered-arenas for eager pinned-host and GPU canonical sources.
	  Each profile pins its source, binaries and cases.

config KNLP_KMESH_NATIVE_SOURCE
	string "Clean pinned LMCache source with matching native extensions"
	default ""

config KNLP_KMESH_NATIVE_OUTPUT
	string "Fresh output directory outside the source checkout"
	default ""

endif

config KNLP_REPRODUCE_KMESH_TRACE
	bool "Audit trace evidence for family residency on CPU"
	default n
	help
	  Measure input-text reuse and field coverage in pinned public traces.
	  Keep record spacing separate from measured invocation and fork times.
	  Missing lineage or cache observations cannot qualify a pressure result.

if KNLP_REPRODUCE_KMESH_TRACE

config KNLP_KMESH_TRACE_ROOT
	string "Trace checkout or captured invocation directory"
	default ""

config KNLP_KMESH_TRACE_OUTPUT
	string "Fresh audit output directory"
	default "results/kmesh-trace-audit"

config KNLP_KMESH_TRACE_MODE
	string "Trace format: lmcache or invocations"
	default "lmcache"

endif

config KNLP_REPRODUCE_KMESH_RESIDENCY
	bool "Qualify family references and capture branching workloads"
	default n
	help
	  Compare a bounded ancestor hold with stock prefix caching under a
	  controlled synthetic request order. Use CPU allocator metadata or
	  synchronous model capture. This does not replay a production trace.

if KNLP_REPRODUCE_KMESH_RESIDENCY

config KNLP_KMESH_RESIDENCY_MODE
	string "Qualification mode: cpu, serving or tot"
	default "cpu"

config KNLP_KMESH_RESIDENCY_SOURCE
	string "Clean qualified vLLM source directory"
	default ""

config KNLP_KMESH_RESIDENCY_MODEL
	string "Local model snapshot for serving capture"
	default ""

config KNLP_KMESH_RESIDENCY_WORKLOAD_SOURCE
	string "Pinned Tree of Thoughts source directory"
	default ""

config KNLP_KMESH_RESIDENCY_OUTPUT
	string "Fresh qualification output directory"
	default "results/kmesh-family-residency"

endif

config KNLP_REPRODUCE_KMESH_FORK
	bool "Enable the real vLLM CPU allocator experiment"
	default n
	help
	  Compare cached and uncached exact-prefix reasoning trees using
	  KVCacheManager metadata. This does not execute a model or GPU.

if KNLP_REPRODUCE_KMESH_FORK

config KNLP_KMESH_FORK_PROFILE
	string "Runtime profile: historical or current"
	default "historical"
	help
	  Keep the workload fixed while selecting an explicit source/runtime
	  pair. The current profile runs locally with GPU visibility disabled.

config KNLP_KMESH_FORK_OUTPUT
	string "Fresh output directory"
	default "results/kmesh-forks"

config KNLP_KMESH_FORK_VLLM_SOURCE
	string "Clean pinned fork-accounting vLLM checkout"
	default ""

config KNLP_KMESH_FORK_RUNTIME_VOLUME
	string "Docker volume containing the pinned Python runtime"
	default ""

config KNLP_KMESH_FORK_DOCKER
	string "Container command prefix"
	default "docker"

config KNLP_KMESH_FORK_PYTHON
	string "Current profile's prepared native Python interpreter"
	default ""

config KNLP_KMESH_FORK_WHEEL_PACKAGE
	string "Current profile's matching installed vLLM package directory"
	default ""

endif

config KNLP_REPRODUCE_KMESH_SERVING
	bool "Replay exact-prefix forks through the current serving engine"
	default n
	help
	  Run the original warm, cold, burst, eviction and decode-fork cases
	  with a real model on an available GPU and the prepared runtime.

if KNLP_REPRODUCE_KMESH_SERVING

config KNLP_KMESH_SERVING_OUTPUT
	string "Fresh serving output directory"
	default "results/kmesh-serving"

config KNLP_KMESH_SERVING_VLLM_SOURCE
	string "Clean pinned serving-replay vLLM checkout"
	default ""

config KNLP_KMESH_SERVING_WHEEL_PACKAGE
	string "Matching installed vLLM wheel package"
	default ""

config KNLP_KMESH_SERVING_MODEL_DIR
	string "Pinned model snapshot directory"
	default ""

endif

config KNLP_REPRODUCE_KMESH_RESTORE
	bool "Compare host-staged and DMA-BUF ancestor restoration"
	default n
	help
	  Restore an exact-prefix ancestor through the production LMCache
	  multiprocess connector. Run transport measurements and optional
	  strict serving qualification on an available GPU.

if KNLP_REPRODUCE_KMESH_RESTORE

config KNLP_KMESH_RESTORE_OUTPUT
	string "Fresh restore output directory on qualified NVMe"
	default "results/kmesh-restore"

config KNLP_KMESH_RESTORE_VLLM_SOURCE
	string "Clean pinned serving-replay vLLM checkout"
	default ""

config KNLP_KMESH_RESTORE_LMCACHE_SOURCE
	string "Clean pinned restore-validation LMCache checkout"
	default ""

config KNLP_KMESH_RESTORE_MODEL_DIR
	string "Authenticated local model snapshot"
	default ""

config KNLP_KMESH_RESTORE_GPU_PROVIDER
	string "GPU buffer exporter: native or vulkan_rm"
	default "vulkan_rm"
	help
	  The RTX 4090 qualification uses the experimental Vulkan/RM provider.
	  Use native only after qualifying CUDA DMA-BUF export on the host.

config KNLP_KMESH_RESTORE_SECTION
	string "Scope: adapter, all, coldburst, singleflight, family, retained, prefetch"
	default "adapter"
	help
	  Adapter reproduces the qualified transport comparison. All also
	  runs the serving gate, which can reject cold-burst recomputation.
	  Coldburst compares simultaneous arrivals with a completed leader,
	  recording backend reads and live ancestor destination blocks.
	  Singleflight compares disabled and enabled exact-prefix load gates
	  on their separately pinned LMCache source, including backend reads.
	  Family releases children during a declared ancestor preload, against
	  reactive coalescing and a fully warm control, with unused-work checks.
	  Retained compares an engine preload against stock retained external-L1
	  prefetch followed by the same preload, including its storage work.
	  Prefetch compares read-once retained demand against early loading at
	  fixed request deadlines, with an independent-process pilot and confirmation.

if KNLP_KMESH_RESTORE_SECTION = "prefetch"

config KNLP_KMESH_RESTORE_PHASE
	string "Loading comparison: qualification, pilot, confirmation"
	default "qualification"

config KNLP_KMESH_RESTORE_QUALIFIED
	string "Accepted native qualification capture"
	default "results/kmesh-prefetch/qualification"

config KNLP_KMESH_RESTORE_PILOT
	string "Accepted complete pilot capture"
	default "results/kmesh-prefetch/pilot"

endif

endif

config KNLP_REPRODUCE_KMESH_CASCADE
	bool "Compare shared-prefix cascade attention on the current vLLM"
	default n
	help
	  Replay the original 8B reasoning family with disabled, natural and
	  forced cascade policies. Check actual kernel engagement separately
	  from timing and generated-token differences. Use an available GPU.

if KNLP_REPRODUCE_KMESH_CASCADE

config KNLP_KMESH_CASCADE_OUTPUT
	string "Fresh cascade output directory"
	default "results/kmesh-cascade"

config KNLP_KMESH_CASCADE_VLLM_SOURCE
	string "Clean pinned serving-replay vLLM checkout"
	default ""

config KNLP_KMESH_CASCADE_MODEL_DIR
	string "Authenticated Llama-3.1-8B-Instruct snapshot"
	default ""

endif
endmenu
```
