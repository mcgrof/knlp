## .kdevops/workflows/knlp/Kconfig
```kconfig
# SPDX-License-Identifier: copyleft-next-0.3.1
#
# knlp workflow Kconfig

config KDEVOPS_USER_WORKFLOW_KNLP
	bool "Enable the knlp ML research workflow"
	default y
	output yaml
	help
	  This enables the knlp (Kernel Natural Language Processing) workflow.
	  knlp is a collaborative transformer architecture research project that
	  applies Linux kernel development methodologies to machine learning
	  experimentation and reproducibility.

	  Repository: https://github.com/mcgrof/knlp

if KDEVOPS_USER_WORKFLOW_KNLP

menu "knlp ML research workflow configuration"

config WORKFLOW_KNLP_GIT_URL
	string "knlp git repository URL"
	default "https://github.com/mcgrof/knlp.git"
	output yaml
	help
	  The git repository URL for knlp.

config WORKFLOW_KNLP_GIT_REF
	string "knlp git reference (branch, tag, or commit)"
	default "main"
	output yaml
	help
	  The git reference to checkout.

config WORKFLOW_KNLP_DATA_PATH
	string "Path to install knlp"
	default "/data/knlp"
	output yaml
	help
	  The directory where knlp will be cloned and installed.

config WORKFLOW_KNLP_KVTIDE
	bool "Provision KVTide storage bench dependencies"
	default n
	output yaml
	help
	  Install the packages knlp's KVTide harness needs for its software
	  NVMe-KV target and physical PCIe NVM comparison modes. The latter
	  compares current xNVMe uPCIe and SPDK against Linux io_uring_cmd
	  with ordinary, registered and blk_iobuf-premapped buffers.

	  After bringup, on the node:
	    cd <knlp data path>
	    make defconfig-kvtide-ab && make

config WORKFLOW_KNLP_KVTIDE_UPCIE_CUDA
	bool "Install uPCIe GPU-memory DKMS modules"
	depends on WORKFLOW_KNLP_KVTIDE
	default n
	output yaml
	help
	  Install the out-of-tree dmabuf-import and iommu-map-pa modules
	  required by current xNVMe main for NVMe peer-to-peer reads into
	  CUDA memory. The modules come from the configured uPCIe release.
	  This does not install the NVIDIA driver or CUDA toolkit.

config WORKFLOW_KNLP_KVTIDE_UPCIE_RELEASE
	string "uPCIe release carrying the DKMS packages"
	depends on WORKFLOW_KNLP_KVTIDE_UPCIE_CUDA
	default "v0.8.0"
	output yaml

config WORKFLOW_KNLP_KVTIDE_UPCIE_DKMS_VERSION
	string "uPCIe DKMS package version"
	depends on WORKFLOW_KNLP_KVTIDE_UPCIE_CUDA
	default "0.2.0"
	output yaml

endmenu

endif # KDEVOPS_USER_WORKFLOW_KNLP
```

## Kconfig.context_artifacts
```kconfig
# SPDX-License-Identifier: MIT
menuconfig KNLP_CONTEXT_ARTIFACTS
	bool "Context artifact file transport"
	default n
	help
	  Import immutable tensor artifacts and verify file load/restore.
	  Engine integration and LMCache acceptance fail until qualified.

if KNLP_CONTEXT_ARTIFACTS

choice
	prompt "Method"
config KNLP_CA_METHOD_LPC
	bool "lpc"
config KNLP_CA_METHOD_MEMORILLA
	bool "memorilla"
endchoice

choice
	prompt "Control or generalized artifact"
config KNLP_CA_PROFILE_BASELINE
	bool "baseline"
config KNLP_CA_PROFILE_PORT_CONTROL
	bool "port control"
config KNLP_CA_PROFILE_ARTIFACT
	bool "artifact"
endchoice

choice
	prompt "Representation"
config KNLP_CA_REP_PREFIX_KV
	bool "prefix kv"
config KNLP_CA_REP_DOCUMENT_EMBEDDINGS
	bool "document embeddings"
config KNLP_CA_REP_INPUT_EMBEDDINGS
	bool "input embeddings"
endchoice

choice
	prompt "Storage backend"
config KNLP_CA_BACKEND_FILES
	bool "files"
config KNLP_CA_BACKEND_LMCACHE
	bool "lmcache"
endchoice

choice
	prompt "Test operation"
config KNLP_CA_OP_SMOKE
	bool "smoke"
config KNLP_CA_OP_LOAD_ONLY
	bool "load only"
config KNLP_CA_OP_EVICT_RESTORE
	bool "evict restore"
config KNLP_CA_OP_RESTART_RESTORE
	bool "restart restore"
config KNLP_CA_OP_ISOLATION
	bool "isolation"
config KNLP_CA_OP_ALL
	bool "all"
endchoice

config KNLP_CA_WORK_ROOT
	string "Persistent source root"
	default ""

config KNLP_CA_BUILD_ROOT
	string "Persistent build root"
	default ""

config KNLP_CA_RESULTS_ROOT
	string "Persistent run evidence root"
	default ""

config KNLP_CA_STORE_ROOT
	string "Persistent artifact store"
	default ""

config KNLP_CA_SOURCE_LOCK
	string "Source lock JSON"
	default ""

config KNLP_CA_MANIFEST
	string "Import manifest JSON"
	default ""

config KNLP_CA_PAYLOAD
	string "Import safetensors payload"
	default ""

config KNLP_CA_ARTIFACT_ID
	string "Required immutable artifact ID"
	default ""

config KNLP_CA_CONSUMER
	string "Consumer model ID"
	default ""

config KNLP_CA_CONSUMER_REVISION
	string "Exact consumer revision"
	default ""

endif
```

## Kconfig.cs312
```kconfig
# SPDX-License-Identifier: MIT
menu "CS312 tutorial: empirical machine learning on a small decoder"

config KNLP_CS312
	bool "Enable the CS312 deep-learning-alchemy tutorial lane"
	default n
	help
	  Run the Stanford CS312 "Deep Learning Alchemy" assignment sweeps
	  on the course's small Llama-style decoder (the d8 model organism:
	  8 layers, hidden 512, about 35M parameters, 614M training tokens).
	  The course code is an external checkout pinned by revision; knlp
	  ships only the sweep planner, launcher glue and report.

if KNLP_CS312

config KNLP_CS312_ASSIGNMENTS_DIR
	string "Checkout directory for the course repository"
	default "~/.cache/knlp/cs312/assignments"
	help
	  Where the course repository is cloned and its uv environment is
	  built. A leading ~ expands to the home directory. The directory is
	  created by make cs312-fetch when missing.

config KNLP_CS312_ASSIGNMENTS_URL
	string "Course repository URL"
	default "https://github.com/deep-learning-alchemy/assignments.git"

config KNLP_CS312_ASSIGNMENTS_REV
	string "Pinned course repository commit"
	default "4350166ac1cedba0222a3124a2a2a54b65fb635d"
	help
	  The exact commit that the plan was written against. The runner
	  checks the checkout out at this commit and refuses to launch when
	  the head differs.

choice
	prompt "Assignment problem"
	default KNLP_CS312_PROBLEM_P1A

config KNLP_CS312_PROBLEM_P1A
	bool "Problem 1(a): one hyperparameter at a time on a log grid"
	help
	  Vary warmup, learning rate, batch size and weight decay one at a
	  time around the d8 defaults. Each axis is a log-spaced grid with
	  the configured base and number of steps. The training horizon
	  stays fixed, so every run is compute matched.

config KNLP_CS312_PROBLEM_P1B
	bool "Problem 1(b): pairs of hyperparameters that co-vary"
	help
	  Move two hyperparameters at once on the same grid as problem
	  1(a) and read whether they compensate. The single-axis cells and
	  the baseline are taken from a finished 1(a) output directory
	  (KNLP_CS312_REFERENCE_OUTPUT) instead of being rerun. Two baseline
	  repeats at new paired seeds give the noise floor.

endchoice

config KNLP_CS312_P1B_PAIRS
	string "Pairs to test, comma separated as first:second"
	default "learning_rate:batch_size,learning_rate:weight_decay,learning_rate:warmup_percent,batch_size:warmup_percent,batch_size:weight_decay,weight_decay:warmup_percent"
	depends on KNLP_CS312_PROBLEM_P1B

config KNLP_CS312_P1B_FULL_CORNERS
	bool "Run the plain 2x2 corners for every pair"
	default n
	depends on KNLP_CS312_PROBLEM_P1B
	help
	  Off, the planner uses a trimmed design: more cells on the pairs
	  where theory predicts compensation, including two outer-ring
	  cells for batch 256 and learning rate 0.027, and two control
	  cells on the expected weak pairs. On, every pair gets the four
	  corners one step from the baseline.

config KNLP_CS312_P1B_SEED_REPEATS
	int "Baseline repeats at new paired model and data seeds"
	default 2
	range 0 8
	depends on KNLP_CS312_PROBLEM_P1B

config KNLP_CS312_REFERENCE_OUTPUT
	string "Output directory of a finished plan whose cells this plan reuses"
	default ""
	help
	  For problem 1(b), the problem 1(a) output directory. Its
	  results.json supplies the baseline and single-axis cells to the
	  pair tables; run make cs312-collect there first.

config KNLP_CS312_P1A_BASE
	string "Log-grid multiplier for learning rate, weight decay and warmup"
	default "3"
	depends on KNLP_CS312_PROBLEM_P1A
	help
	  Successive grid points differ by this factor. The handout
	  suggests 3.

config KNLP_CS312_P1A_BATCH_BASE
	string "Log-grid multiplier for batch size"
	default "2"
	depends on KNLP_CS312_PROBLEM_P1A
	help
	  Batch sizes must be integers, and the course launcher expects
	  gradient accumulation above 256 sequences. The default of 2 gives
	  16, 32, 64, 128 and 256 with five steps. Set 3 for 7, 21, 64,
	  192 and 576.

config KNLP_CS312_P1A_STEPS
	int "Grid points per axis, including the default"
	default 5
	range 2 9
	depends on KNLP_CS312_PROBLEM_P1A
	help
	  An odd count centres the grid on the default. The default point
	  is shared by every axis, so five steps on four axes give 17 runs.

config KNLP_CS312_P1A_AXES
	string "Axes to sweep, comma separated"
	default "warmup_percent,learning_rate,batch_size,weight_decay"
	depends on KNLP_CS312_PROBLEM_P1A

config KNLP_CS312_DEPTH
	int "Model depth from the built-in d4 to d18 ladder"
	default 8
	range 4 18
	help
	  Depth sets every other dimension: hidden size is 64 times depth,
	  one head per 64 hidden units, MLP width 3.5 times hidden.

config KNLP_CS312_NUM_TRAIN_SEQUENCES
	int "Training sequences of 1024 tokens per run"
	default 600000
	help
	  600,000 sequences is the course default, 614.4M tokens. Smaller
	  values give a quick rehearsal; they are not the course recipe.

choice
	prompt "Execution backend"
	default KNLP_CS312_BACKEND_MODAL

config KNLP_CS312_BACKEND_MODAL
	bool "Modal serverless GPUs through the course launcher"
	help
	  Runs every configuration as its own detached Modal function, as
	  the course does. Needs a Modal account, the course data on a
	  Modal Volume (make cs312-data) and a W&B secret named
	  dl-alchemy-wandb in the selected environment.

config KNLP_CS312_BACKEND_LOCAL
	bool "One local GPU, runs executed in sequence"
	help
	  Runs each configuration in a fresh process on the visible GPU.
	  Needs the course data downloaded locally (make cs312-data). Each
	  finished run leaves a receipt, so an interrupted sweep resumes.

endchoice

config KNLP_CS312_MODAL_GPU
	string "Modal GPU type"
	default "H100"
	depends on KNLP_CS312_BACKEND_MODAL

config KNLP_CS312_MODAL_ENVIRONMENT
	string "Modal environment holding the data volume and secrets"
	default "main"
	depends on KNLP_CS312_BACKEND_MODAL

config KNLP_CS312_MODAL_MAX_PARALLEL
	int "Maximum concurrent Modal containers (0 means one per run)"
	default 0
	depends on KNLP_CS312_BACKEND_MODAL

config KNLP_CS312_LOCAL_PARALLEL
	int "Concurrent training processes on the local GPU"
	default 1
	range 1 8
	depends on KNLP_CS312_BACKEND_LOCAL

config KNLP_CS312_PYTHON
	string "Interpreter for the course code (empty uses uv run)"
	default ""
	help
	  Leave empty to let uv build and use the course's pinned
	  environment. Set an explicit interpreter when the pinned CUDA
	  wheels do not fit the machine, for example a ROCm PyTorch venv.

config KNLP_CS312_SCRATCH_ROOT
	string "Local scratch root for data and checkpoints (empty uses ~/dl_alchemy)"
	default ""

config KNLP_CS312_TORCH_COMPILE_MODE
	string "torch.compile mode override (empty keeps the course default)"
	default ""

config KNLP_CS312_NUM_EVALS
	int "Validation evaluations per run (0 keeps the course default of 100)"
	default 0
	range 0 1000
	help
	  The course evaluates 100 times per run, which on a short rehearsal
	  means every step. Set a small count for throughput probes. It does
	  not change the training trajectory or the plan digest.

config KNLP_CS312_WANDB_ONLINE
	bool "Log runs to Weights & Biases"
	default y

config KNLP_CS312_WANDB_ENTITY
	string "W&B entity (empty uses the account default)"
	default ""

config KNLP_CS312_WANDB_PROJECT
	string "W&B project"
	default "cs312"

config KNLP_CS312_RUN_SUFFIX
	string "Run-name suffix (empty uses the backend name)"
	default ""
	help
	  Appended to every run name and added as a W&B tag, so the same
	  plan executed on two backends stays distinguishable.

config KNLP_CS312_OUTPUT
	string "Output directory for the plan, receipts and report"
	default "results/cs312-problem-1"

endif
endmenu
```

## Kconfig.dmabuf
```kconfig
# SPDX-License-Identifier: MIT
menu "io_uring DMA-BUF enablement"

config KNLP_DMABUF
	bool "Enable the pinned DMA-BUF reproduction workflow"
	default n
	help
	  Select defconfig-io-uring-dmabuf for source preparation, kernel
	  builds and separate CPU, storage and GPU checks. Plain make
	  prints the plan; installation and hardware tests are explicit.

if KNLP_DMABUF
config KNLP_DMABUF_WORKDIR
	string "Dedicated source, build and result directory"
	default ".cache/io-uring-dmabuf"

config KNLP_DMABUF_BASE_CONFIG
	string "Base kernel config (empty uses the running kernel config)"
	default ""

config KNLP_DMABUF_JOBS
	int "Kernel build jobs"
	default 4
	range 1 256

config KNLP_DMABUF_SCRATCH
	string "Existing owned scratch directory on NVMe-backed XFS/ext4"
	default ""
	help
	  Tests create new files here. A raw block device is not accepted.

config KNLP_DMABUF_EXPORTER
	string "Host-memory selftest exporter: sysheap or udmabuf"
	default "sysheap"

config KNLP_DMABUF_GPU_PROVIDER
	string "GPU staging provider: native or vulkan_rm"
	default "native"

config KNLP_DMABUF_GPU
	string "GPU PCI address for the topology diagnostic"
	default ""

config KNLP_DMABUF_NVME
	string "NVMe controller PCI address for the topology diagnostic"
	default ""
endif
endmenu
```
