## Kconfig.rpl2
```kconfig
# SPDX-License-Identifier: MIT
# Configuration for the basic KV-offload read-path reproduction.
#
# Selecting rpl2-smoke or rpl2-mounted-fs sets these values.  Plain `make`
# then runs the selected profile through Makefile.rpl2.  All symbols are
# namespaced CONFIG_KNLP_RPL2_* so this profile never collides with
# another reproduce profile.

menuconfig KNLP_REPRODUCE_RPL2
	bool "KV-offload read path on a mounted filesystem"
	default n
	help
	  A basic reproduction for the question of how much work a KV-cache
	  offload read does before and while its bytes move.  The smoke
	  profile runs CPU-only unit tests.  The mounted-filesystem profile
	  writes a few immutable objects to a directory you name, reads
	  each one back as a whole request, verifies every byte against its
	  digest and records the request latency.

	  Neither profile needs root, a GPU or a network service of its
	  own, and neither drops caches or changes kernel settings.

if KNLP_REPRODUCE_RPL2

choice
	prompt "Profile"
	default KNLP_RPL2_SMOKE

config KNLP_RPL2_SMOKE
	bool "CPU-only record, parser and verification tests"
	help
	  Runs the unit tests in tools/reproduce/rpl2/tests on temporary
	  local directories.  Safe to run anywhere, including CI.

config KNLP_RPL2_MOUNTED_FS
	bool "Immutable-object read baseline on an existing mount"
	help
	  Uses an existing directory on any POSIX filesystem, including an
	  NFS mount that you set up.  Nothing is mounted or configured for
	  you.

config KNLP_RPL2_PNFS_LAB
	bool "pNFS lab on one host: stock LMCache against held descriptors"
	help
	  Builds a pNFS metadata server (Lattice with its RonDB catalogue),
	  NFSv3 data servers and a kernel NFSv4.2 client, each in its own
	  network namespace on this host.  It then compares stock LMCache's
	  native file connector with its held_fd_capacity option: a
	  per-phase RPC fingerprint and a paired, alternating-block timing
	  screen.  Needs root (sudo) for namespaces, the per-namespace NFS
	  server, mounts and a private trace instance.  The host's own NFS
	  server, exports and rpcbind are not touched, and teardown checks
	  that they match their baseline.

config KNLP_RPL2_PNFS_SWEEP
	bool "pNFS lab on one host: many clients reading shared hot objects"
	help
	  The same lab, plus N extra clients, each its own NFS client
	  identity, that read the same hot objects at once with and without
	  held descriptors.  Records metadata-server operations and CPU per
	  object read, throughput and latency for each N.

config KNLP_RPL2_PNFS_REMOTE
	bool "Client on this host for a pNFS lab on another host"
	help
	  Mounts a lab that runs on another host (KNLP_RPL2_PNFS_LAB_HOST)
	  through a route to its lab subnet, then runs the fingerprint and
	  the paired screen from here over the real network.  On the lab
	  host, list this host's address in KNLP_RPL2_PNFS_REMOTE_CLIENTS
	  before bringing the lab up.

config KNLP_RPL2_SITE
	bool "Your own filesystem: held descriptors, read modes and NFS RPCs"
	help
	  Runs on a directory you already have, for example on a pNFS
	  deployment with several data servers and many NVMe drives, as an
	  ordinary user.  Nothing is mounted, exported or reconfigured, no
	  cache is dropped, and every file goes into one subdirectory,
	  rpl2-site, of the directory you give.  It builds LMCache only.

	  The steps record the filesystem and NFS mount options, the NFS
	  RPCs each object read sends (from the client's own per-mount
	  counters), a paired screen of open per read against held
	  descriptors, many reader processes on this host, and the three
	  read_mode settings at several requests in flight.  The defconfig
	  rpl2-closure runs only the fingerprint and the screen with the
	  published held-descriptor build, which reproduces the read-plan
	  closing measurement at any position you mount.

config KNLP_RPL2_VLLM
	bool "Your own filesystem: vLLM through the LMCache MP server"
	help
	  An end-to-end test of held descriptors: vLLM serves a model through
	  the LMCache multiprocess (MP) server, whose fs_native L2 adapter
	  stores KV-cache chunks on a directory you give, for example on an
	  NFS or pNFS mount.  Each request has a long prefix that the L2
	  holds and LMCache's host-memory L1 does not, so every request loads
	  its prefix from the filesystem.  The run records the time to first
	  token and requests per second with held_fd_capacity 0 (stock) and
	  with held descriptors, for buffered and O_DIRECT reads, plus vLLM
	  without LMCache as the recompute baseline.

	  Needs one NVIDIA GPU, a Python environment with vLLM and CUDA
	  PyTorch, the CUDA toolkit to build LMCache's extensions, and the
	  model.  Nothing is installed into that environment; LMCache is
	  built in the task root.  Runs as an ordinary user.

config KNLP_RPL2_VLLM_PNFS_LAB
	bool "pNFS lab on one host: vLLM through the LMCache MP server"
	help
	  The same vLLM test with the L2 on the one-host pNFS lab, where
	  every open is a request to the metadata server.  It also repeats
	  each measurement while the lab's extra clients load the metadata
	  server, as other inference nodes sharing it would, and records the
	  metadata server's operations per request.  Needs root (sudo) for
	  the lab, and the GPU environment of the previous profile.

endchoice

config KNLP_RPL2_VLLM_ANY
	bool
	default y if KNLP_RPL2_VLLM || KNLP_RPL2_VLLM_PNFS_LAB

config KNLP_RPL2_TARGET_DIR
	string "Existing directory for the test objects"
	default ""
	depends on KNLP_RPL2_MOUNTED_FS
	help
	  Must exist, be writable and lie outside the source tree.  The
	  objects go into a subdirectory named after the seed, size and
	  count, and a later run reuses them only when its manifest
	  matches.  Override with RPL2_TARGET=/path on the make command.

config KNLP_RPL2_OUTPUT_DIR
	string "Directory for request records"
	default ""
	depends on KNLP_RPL2_MOUNTED_FS
	help
	  Each run writes rpl2-<UTC time>/records.jsonl here; the report
	  writes summary.json next to it.  Must lie outside the source
	  tree.  Override with RPL2_OUTPUT=/path on the make command.

choice
	prompt "I/O mode"
	default KNLP_RPL2_IO_DIRECT
	depends on KNLP_RPL2_MOUNTED_FS

config KNLP_RPL2_IO_DIRECT
	bool "O_DIRECT reads into a page-aligned buffer"
	help
	  Bypasses the client page cache where the filesystem honors
	  O_DIRECT, so reads reach the storage or server.  When the
	  filesystem refuses O_DIRECT the run records a skip with its
	  reason instead of silently reading buffered.

config KNLP_RPL2_IO_BUFFERED
	bool "Ordinary buffered reads"
	help
	  Reads may be served from the client page cache, especially right
	  after the objects are written.  The records say so.

endchoice

config KNLP_RPL2_OBJECT_BYTES
	int "Bytes per object"
	default 8388608
	depends on KNLP_RPL2_MOUNTED_FS
	help
	  Direct I/O needs a multiple of 4096.

config KNLP_RPL2_OBJECTS
	int "Number of objects"
	range 1 100000
	default 16
	depends on KNLP_RPL2_MOUNTED_FS

config KNLP_RPL2_REQUESTS
	int "Requests to time"
	range 1 10000000
	default 64
	depends on KNLP_RPL2_MOUNTED_FS
	help
	  Requests visit the objects in order and wrap around.  Every
	  request is recorded, including the first touch of each object.

config KNLP_RPL2_SEED
	int "Seed for the object contents"
	default 1
	depends on KNLP_RPL2_MOUNTED_FS

if KNLP_RPL2_PNFS_LAB || KNLP_RPL2_PNFS_SWEEP || KNLP_RPL2_PNFS_REMOTE || KNLP_RPL2_SITE || KNLP_RPL2_VLLM_ANY

config KNLP_RPL2_PNFS_ROOT
	string "Task root directory for sources, builds and lab state"
	default ""
	help
	  An owned directory on a disk filesystem (not tmpfs), outside the
	  source tree.  setup.sh builds everything into it; lab runtime
	  state, some of it root-owned, also lives here.  Override with
	  RPL2P_ROOT=/path on the make command.

config KNLP_RPL2_PNFS_OUTPUT_DIR
	string "Directory for run records"
	default ""
	help
	  Each run writes a timestamped subdirectory here.  Must lie outside
	  the source tree.  Override with RPL2_OUTPUT=/path.

config KNLP_RPL2_PNFS_PYTHON
	string "Python with torch for building LMCache (empty: create one with uv)"
	default ""
	depends on !KNLP_RPL2_VLLM

config KNLP_RPL2_PNFS_LMCACHE_REPO
	string "LMCache repository"
	default "https://github.com/mcgrof/LMCache.git"

config KNLP_RPL2_PNFS_LMCACHE_REF
	string "LMCache branch"
	default "2026-10-31-proto-fs-native-inline-reads" if KNLP_RPL2_SITE
	default "2026-10-28-feature-fs-native-held-fd"

config KNLP_RPL2_PNFS_LMCACHE_COMMIT
	string "LMCache commit, checked after checkout"
	default "e76f8f181c954de6ba8a80d013aa2fba0bbe8faf" if KNLP_RPL2_SITE
	default "fc836c1303eaced6363fe79ec59e5cba5edf8eaa"
	help
	  The read_mode steps need a build with read_mode (the site
	  default).  The published held-descriptor build has no read_mode;
	  with it, turn the read_mode step off.

config KNLP_RPL2_PNFS_PREFIX
	string "Lab name prefix for namespaces, units and interfaces"
	depends on !KNLP_RPL2_SITE && !KNLP_RPL2_VLLM
	default "rpl2p"
	help
	  At most 6 characters.  Two labs on one host need different
	  prefixes and subnets.

config KNLP_RPL2_PNFS_NET
	string "Private /24 subnet of the lab, first three octets"
	depends on !KNLP_RPL2_SITE && !KNLP_RPL2_VLLM
	default "10.247.0"
	help
	  Must not be routed on the host already; the lab refuses to start
	  otherwise.

config KNLP_RPL2_PNFS_DATA_SERVERS
	int "Data servers"
	range 1 8
	default 1
	depends on !KNLP_RPL2_PNFS_REMOTE && !KNLP_RPL2_SITE && !KNLP_RPL2_VLLM

config KNLP_RPL2_PNFS_HELD_CAPACITY
	int "held_fd_capacity for the held-descriptor arm"
	default 64
	depends on !KNLP_RPL2_VLLM_ANY

config KNLP_RPL2_PNFS_BLOCKS
	int "Paired blocks in the screen"
	default 3
	depends on !KNLP_RPL2_PNFS_SWEEP && !KNLP_RPL2_VLLM_ANY

config KNLP_RPL2_PNFS_REQUESTS
	int "Requests per arm per block"
	default 200
	depends on !KNLP_RPL2_PNFS_SWEEP && !KNLP_RPL2_VLLM_ANY

config KNLP_RPL2_PNFS_CLIENTS
	string "Client counts for the sweep"
	default "1 2 4 8 16"
	depends on KNLP_RPL2_PNFS_SWEEP || KNLP_RPL2_SITE
	help
	  In the site profile these are reader processes on this host.
	  They share this host's NFS client identity, unlike the lab's
	  clients, which each have their own.

config KNLP_RPL2_PNFS_SECONDS
	int "Seconds per sweep cell"
	default 20
	depends on KNLP_RPL2_PNFS_SWEEP || KNLP_RPL2_SITE

config KNLP_RPL2_PNFS_SWEEP_FIXTURE
	string "Sweep fixture: rpl2-256k (metadata-bound) or rpl2-8m"
	default "rpl2-256k"
	depends on KNLP_RPL2_PNFS_SWEEP

if KNLP_RPL2_SITE

config KNLP_RPL2_SITE_DIR
	string "Existing writable directory on the filesystem under test"
	default ""
	help
	  The run creates rpl2-site inside it and touches nothing else.
	  It needs about 1.1 GiB free.  Override with RPL2_SITE=/path on
	  the make command.

config KNLP_RPL2_SITE_LABEL
	string "A name for this position or deployment, recorded only"
	default ""
	help
	  For example local, loopback, remote-1g or site-a.

config KNLP_RPL2_SITE_DATA_SERVERS
	string "Data servers behind the mount, recorded only"
	default ""

config KNLP_RPL2_SITE_DRIVES
	string "NVMe drives behind the mount, recorded only"
	default ""

config KNLP_RPL2_SITE_MDS_METRICS
	string "Lattice MDS metrics URL, read before and after each sweep cell"
	default ""
	help
	  For example http://mds:9090/metrics.  Empty skips the server
	  side; the client's own RPC counts are always recorded.

config KNLP_RPL2_SITE_FINGERPRINT
	bool "Record NFS RPCs per object read, stock and held"
	default y

config KNLP_RPL2_SITE_SCREEN
	bool "Paired screen: open per read against held descriptors"
	default y

config KNLP_RPL2_SITE_SWEEP
	bool "Many reader processes at once, stock and held"
	default y

config KNLP_RPL2_SITE_READMODES
	bool "read_mode pool, inline and adaptive"
	default y

config KNLP_RPL2_SITE_INFLIGHT
	string "Requests in flight for the read_mode step"
	default "1 4 16"
	depends on KNLP_RPL2_SITE_READMODES

config KNLP_RPL2_SITE_MODES
	string "read_mode values to run"
	default "pool inline adaptive"
	depends on KNLP_RPL2_SITE_READMODES

config KNLP_RPL2_SITE_BUSY_TARGET
	int "read_busy_target for adaptive"
	default 16
	depends on KNLP_RPL2_SITE_READMODES

config KNLP_RPL2_SITE_KERNEL
	bool "NFS client open scaling selftest (nfs_open_scale)"
	default n
	help
	  Runs the kernel selftest nfs_open_scale on the directory: N
	  threads open and close 64 small files and it reports opens per
	  second at each thread count, with the threads sharing one
	  credential as an LMCache reader pool does.  It is the A/B test
	  for an NFSv4 client change to state-owner locking: boot the
	  base and the patched kernel in turn on the client and run this
	  step on each.  The step is skipped unless
	  KNLP_RPL2_SITE_KERNEL_SELFTEST names the built binary.  The
	  four commits, the selftest first, are on the public branch
	  2026-10-30-dmabuf-on-axboe-for-7.4-nfs of
	  git.kernel.org/pub/scm/linux/kernel/git/mcgrof/linux.git; build
	  the selftest there with
	  make -C tools/testing/selftests TARGETS=filesystems/nfs.

config KNLP_RPL2_SITE_KERNEL_SELFTEST
	string "Path to the open/close selftest binary"
	default ""
	depends on KNLP_RPL2_SITE_KERNEL

config KNLP_RPL2_SITE_KERNEL_THREADS
	string "Thread counts for the selftest, comma separated"
	default "1,2,4,8"
	depends on KNLP_RPL2_SITE_KERNEL

endif

config KNLP_RPL2_PNFS_REMOTE_CLIENTS
	string "Addresses of client hosts allowed to mount this lab"
	default ""
	depends on !KNLP_RPL2_PNFS_REMOTE && !KNLP_RPL2_SITE && !KNLP_RPL2_VLLM_ANY
	help
	  Space-separated.  When set, bringing the lab up also adds the
	  route back to those hosts and two accept rules for the lab subnet
	  in the DOCKER-USER chain, which teardown removes.

if KNLP_RPL2_VLLM_ANY

config KNLP_RPL2_VLLM_PYTHON
	string "Python with vLLM and CUDA PyTorch"
	default ""
	help
	  The interpreter of an existing vLLM environment, for example
	  /opt/vllm/bin/python.  LMCache is built against its PyTorch and
	  put on PYTHONPATH; nothing is installed into it.  Override with
	  RPL2_VLLM_PYTHON=/path.

config KNLP_RPL2_VLLM_CUDA_HOME
	string "CUDA toolkit for building LMCache's extensions"
	default "/usr/local/cuda"

config KNLP_RPL2_VLLM_DIR
	string "Existing writable directory on the filesystem under test"
	default ""
	depends on KNLP_RPL2_VLLM
	help
	  The run creates one rpl2-vllm-<time> subdirectory in it for the
	  L2 and touches nothing else.  It needs about prompts x prefix
	  tokens x the model's KV bytes per token, twice (one copy per I/O
	  mode): 32 GiB for the defaults with an 8B Llama model.  Override
	  with RPL2_VLLM_DIR=/path.

config KNLP_RPL2_VLLM_MODEL
	string "Model"
	default "meta-llama/Llama-3.1-8B-Instruct"
	help
	  A model vLLM can serve on the GPU with room for four 8K-token
	  requests.  Llama-3.1-8B stores 128 KiB of KV per token, so one
	  256-token LMCache chunk is a 32 MiB object.

config KNLP_RPL2_VLLM_PROMPTS
	int "Distinct prompt prefixes"
	default 16

config KNLP_RPL2_VLLM_PREFIX_TOKENS
	int "Tokens in each prefix, a multiple of 256"
	default 8192

config KNLP_RPL2_VLLM_L1_GB
	int "LMCache L1 (host memory) size in GiB"
	default 8
	help
	  Keep it below the working set (prompts x prefix tokens x KV bytes
	  per token), so prompts sent round robin always miss L1 and load
	  from the filesystem.

config KNLP_RPL2_VLLM_HELD_CAPACITY
	int "held_fd_capacity for the held-descriptor arm"
	default 4096

config KNLP_RPL2_VLLM_IO
	string "fs_native I/O modes: buffered, odirect or both"
	default "buffered odirect"

config KNLP_RPL2_VLLM_SECONDS
	int "Seconds per phase"
	default 60

config KNLP_RPL2_VLLM_CONCURRENCY
	string "Requests in flight, one phase each"
	default "1 4"

config KNLP_RPL2_VLLM_REPEATS
	int "Repeats of each arm, in alternating order"
	default 2

config KNLP_RPL2_VLLM_GPU_UTIL
	string "vLLM GPU memory utilization"
	default "0.90"

config KNLP_RPL2_VLLM_MAX_MODEL_LEN
	int "vLLM maximum model length"
	default 10240

config KNLP_RPL2_VLLM_LOAD_CLIENTS
	int "Extra lab clients that load the metadata server"
	default 8
	depends on KNLP_RPL2_VLLM_PNFS_LAB
	help
	  Each reads the lab's 256 KiB fixture, 16 objects per request, as
	  fast as it can.  Eight saturate one metadata server on a 16-core
	  host with open per read.  The next option sets their descriptor
	  setting.

config KNLP_RPL2_VLLM_LOAD_OPEN_PER_READ
	bool "Keep the load clients on open per read in both arms"
	default y
	depends on KNLP_RPL2_VLLM_PNFS_LAB
	help
	  Keep the load clients on open per read (held 0) in both arms, so
	  the metadata server stays busy in both and only vLLM's own
	  setting changes.  Say N to let the load clients follow the arm
	  (held 64 in the held arm), which compares a fleet that opens per
	  read with a fleet that holds descriptors.

endif

config KNLP_RPL2_PNFS_LAB_HOST
	string "LAN address of the host running the lab"
	default ""
	depends on KNLP_RPL2_PNFS_REMOTE

endif

endif # KNLP_REPRODUCE_RPL2
```
