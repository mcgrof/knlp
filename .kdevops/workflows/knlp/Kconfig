## Kconfig.tensorflow
```kconfig
# SPDX-License-Identifier: MIT
#
# TensorFlow build-system A/B reproduction.

menu "TensorFlow build-system reproduction"

config KNLP_TF_REPRO
	bool "Enable TensorFlow build-system reproduction"
	default n
	help
	  Build the same TensorFlow target with its reference builder, an
	  externally supplied alternative builder, or both. The public harness
	  knows only the adapter contract; alternative implementations remain
	  outside this repository.

choice
	prompt "TensorFlow builder selection"
	depends on KNLP_TF_REPRO
	default KNLP_TF_BUILDER_REFERENCE
	help
	  REFERENCE builds only with TensorFlow's default builder.
	  ALTERNATIVE builds only with an external adapter.
	  A/B sends the same canonical request to both adapters.

config KNLP_TF_BUILDER_REFERENCE
	bool "Reference TensorFlow builder only"

config KNLP_TF_BUILDER_ALTERNATIVE
	bool "Alternative TensorFlow builder only"

config KNLP_TF_BUILDER_AB
	bool "A/B: reference and alternative builders"

endchoice

config KNLP_TF_SOURCE_DIR
	string "Pinned TensorFlow source directory"
	default "/data/tensorflow"
	depends on KNLP_TF_REPRO
	help
	  Existing TensorFlow checkout used by every selected builder. The
	  orchestrator records its Git commit and rejects unrelated dirt by
	  default.

config KNLP_TF_TARGET
	string "TensorFlow target"
	default "//knlp_tensorflow:gemma_savedmodel_runner"
	depends on KNLP_TF_REPRO

config KNLP_TF_ARTIFACT_RELPATH
	string "Artifact path relative to the configured binary directory"
	default "knlp_tensorflow/gemma_savedmodel_runner"
	depends on KNLP_TF_REPRO

config KNLP_TF_BUILD_ARGS
	string "Common TensorFlow build arguments"
	default "--config=opt --config=cuda --repo_env=TF_NEED_TENSORRT=0 --copt=-Wno-unused-command-line-argument"
	depends on KNLP_TF_REPRO
	help
	  Shell-style argument list passed unchanged to every builder.

config KNLP_TF_JOBS
	int "Parallel build jobs (0 = detected CPU count)"
	default 0
	range 0 512
	depends on KNLP_TF_REPRO

config KNLP_TF_RESULTS_ROOT
	string "Build-system reproduction results root"
	default "./results/tensorflow-ab"
	depends on KNLP_TF_REPRO

config KNLP_TF_REFERENCE_BUILDER
	string "Reference builder adapter"
	default "tools/reproduce/tensorflow_ab/builders/bazel.py"
	depends on KNLP_TF_REPRO && !KNLP_TF_BUILDER_ALTERNATIVE

config KNLP_TF_ALTERNATIVE_BUILDER
	string "Alternative builder adapter"
	default ""
	depends on KNLP_TF_REPRO && !KNLP_TF_BUILDER_REFERENCE
	help
	  Executable implementing the public JSON builder contract. It can also
	  be supplied at invocation time with TF_ALT_BUILDER=/path/to/adapter.

config KNLP_TF_BAZEL_BIN
	string "Reference Bazel executable"
	default "bazel"
	depends on KNLP_TF_REPRO && !KNLP_TF_BUILDER_ALTERNATIVE

config KNLP_TF_PROFILE
	bool "Capture build profiles"
	default y
	depends on KNLP_TF_REPRO

config KNLP_TF_FAIL_ON_DIRTY_SOURCE
	bool "Reject unrelated TensorFlow source changes"
	default y
	depends on KNLP_TF_REPRO
	help
	  The managed knlp_tensorflow workload package is excluded from this
	  check. Set TF_ALLOW_DIRTY=1 for an intentional local source change.

config KNLP_TF_DRY_RUN
	bool "Emit requests without invoking builders"
	default n
	depends on KNLP_TF_REPRO

endmenu
```

## Kconfig.tokendance
```kconfig
# SPDX-License-Identifier: MIT
menu "TokenDance-style shared-update baseline"

config KNLP_REPRODUCE_TOKENDANCE
	bool "Enable TokenDance-style recovery reproduction"
	default n

if KNLP_REPRODUCE_TOKENDANCE

config KNLP_TOKENDANCE_MODE
	string "Execution: cpu, gpu (ROCm container), or cuda (native)"
	default "cpu"
	help
	  cpu validates the exact synthetic workload without a model or GPU.
	  gpu runs all eight recovery/control cases in a pinned ROCm container.
	  GPU execution requires an available GPU and the component checkouts.
	  cuda runs the pinned current source/runtime on an available GPU,
	  using the selected Python interpreter.

config KNLP_TOKENDANCE_OUTPUT
	string "Fresh output directory"
	default "results/tokendance"

config KNLP_TOKENDANCE_VLLM_SOURCE
	string "Clean dated vLLM checkout"
	default ""

config KNLP_TOKENDANCE_LMCACHE_SOURCE
	string "Clean dated LMCache checkout"
	default ""

config KNLP_TOKENDANCE_RUNTIME_VOLUME
	string "Docker volume containing the pinned Python environment"
	default ""

config KNLP_TOKENDANCE_MODEL_DIR
	string "Local pinned model snapshot directory"
	default ""

config KNLP_TOKENDANCE_DOCKER
	string "Container command prefix"
	default "docker"

config KNLP_TOKENDANCE_WHEEL_PACKAGE
	string "Current CUDA profile's matching installed vLLM package"
	default ""

endif
endmenu
```

## Kconfig.tutti
```kconfig
# SPDX-License-Identifier: MIT
menu "Tutti GPU-initiated NVMe evaluation"

config TUTTI
	bool "Enable the Tutti storage evaluation workflow"
	default n
	help
	  Fetch and build a pinned public Tutti runtime and a byte-verified
	  GPU/NVMe transfer probe. No io_uring DMA-BUF kernel changes are
	  needed for this arm. Device provisioning remains a separate step.

if TUTTI

config TUTTI_RUN
	bool "Run the storage matrix after building"
	default n
	help
	  Requires an already provisioned Tutti daemon and an explicit
	  disposable file directory. The default workflow only builds.

config TUTTI_GIT
	string "Tutti source repository"
	default "https://github.com/xPU-IO/Tutti.git"

config TUTTI_REV
	string "Exact Tutti commit (40 hexadecimal digits)"
	default "5e48c2ab6deea2ec9972a5f1beb56854f62bf149"

config TUTTI_WORK_DIR
	string "Source and build workspace"
	default "./work/tutti"

config TUTTI_OUTPUT_DIR
	string "Run receipts and raw logs"
	default "./results/tutti"

config TUTTI_CUDA_ARCH
	string "CUDA architecture (90 for H100)"
	default "90"

config TUTTI_JOBS
	int "Parallel build jobs"
	default 8
	range 1 256

config TUTTI_BUILD_MODULE
	bool "Build the SNVMe kernel modules (never load them automatically)"
	default y

config TUTTI_RUNTIME_CONFIG
	string "Single-device Tutti runtime YAML"
	default ""
	help
	  Supply a CUDA/local-nvme runtime config for the daemon's granted
	  device and GPU. An example lives in tools/reproduce/tutti/.

config TUTTI_DIRECTORY
	string "Disposable directory within a daemon-published view"
	default ""
	help
	  Must already exist. Each run creates an exclusive child directory.
	  No raw device name, reformatting or device rebinding is inferred.

config TUTTI_ALLOW_FILE_WRITES
	bool "Permit test files in the configured disposable directory"
	default n

config TUTTI_IO_KIB
	string "Synthetic transfer sizes in KiB"
	default "64 256 1024 4096"

config TUTTI_BATCH_DEPTHS
	string "Requests per submit-and-drain batch"
	default "1 8 32"
	help
	  This is application batch depth, not measured NVMe queue depth.
	  Compare to an identically batched CPU arm for mechanism attribution.

config TUTTI_SPAN_MIB
	int "GPU buffer and backing-file span in MiB"
	default 256
	range 1 1048576

config TUTTI_WARMUPS
	int "Untimed warmup round trips per cell"
	default 1
	range 0 100

config TUTTI_REPEATS
	int "Measured round trips per cell"
	default 5
	range 1 1000

config TUTTI_SEED
	int "Offset-order and cell-order seed"
	default 42
	range 0 2147483647

config TUTTI_RANDOM
	bool "Permute object offsets without replacement"
	default n

config TUTTI_OVERLAP_LAYERS
	int "Layers in the upstream synthetic overlap workload"
	default 4
	range 1 1000

config TUTTI_OVERLAP_CHUNKS
	int "Chunks in the upstream synthetic overlap workload"
	default 16
	range 2 4096

config TUTTI_OVERLAP_TENSOR_KIB
	int "K or V tensor size in KiB for overlap"
	default 512
	range 4 1048576

config TUTTI_OVERLAP_COMPUTE_US
	int "Fixed compute duration per synthetic layer in microseconds"
	default 1000
	range 1 1000000
	help
	  Fixed across arms. Do not use per-backend auto-calibration when
	  comparing overlap: it changes the workload with storage speed.

endif
endmenu
```

## Kconfig.weight_io
```kconfig
# SPDX-License-Identifier: MIT
# Weight-loading I/O characterization: what reaching the weights of an
# open checkpoint costs at the storage device, measured with eBPF
# tracers on real safetensors shards.
#
# Selecting one of the weight-io-* defconfigs sets these values. After
# that, plain `make` runs the configured stages through
# Makefile.weight_io. All symbols are namespaced CONFIG_KNLP_WEIGHT_IO_*.

menu "Weight-loading I/O characterization"

config KNLP_WEIGHT_IO
	bool "Enable the weight-loading I/O characterization"
	default n
	help
	  Set by defconfig-weight-io-inventory, defconfig-weight-io-controls
	  and defconfig-weight-io-full. When set, plain `make` reads the
	  shard headers of the configured checkpoints, downloads the
	  control checkpoints, replays selected byte ranges of them on the
	  local NVMe under the NVMe, syscall and page-fault tracers, and
	  renders the result tables.

if KNLP_WEIGHT_IO

config KNLP_WEIGHT_IO_ROOT
	string "Data root (models, inventory, runs)"
	default "./results/weight-io"
	help
	  Bulk data lives here, outside Git: models/<org>__<name>/full and
	  compact, stageA/ (pins, inventory, selection, projections), runs/
	  (one directory per traced run) and the rendered tables. The
	  device holding this directory is the one that is traced.

config KNLP_WEIGHT_IO_REPOS
	string "Checkpoints to inventory (org/name[@revision], space separated)"
	default "Qwen/Qwen3-0.6B Qwen/Qwen2.5-7B-Instruct Qwen/Qwen2.5-7B-Instruct-AWQ Qwen/Qwen3-Next-80B-A3B-Instruct deepseek-ai/DeepSeek-V3 moonshotai/Kimi-K2-Instruct meta-llama/Llama-3.1-405B"
	help
	  Every shard header of every repository is read by HTTP range
	  request; no payload is downloaded for the inventory. A gated
	  repository needs a Hugging Face token (HF_TOKEN or the token file
	  in HF_HOME).

config KNLP_WEIGHT_IO_CONTROL_REPOS
	string "Checkpoints downloaded in full and replayed locally"
	default "Qwen/Qwen3-0.6B Qwen/Qwen2.5-7B-Instruct Qwen/Qwen2.5-7B-Instruct-AWQ"
	help
	  Whole shards of these repositories are downloaded and verified
	  against the hub's LFS hashes (about 21 GB for the default three).
	  They supply the dense BF16 layer, the smallest embedding rows and
	  the INT4 AWQ layer of the replay matrix.

config KNLP_WEIGHT_IO_FETCH_COMPACT
	bool "Fetch the selected byte ranges of the other checkpoints"
	default n
	help
	  Downloads only the selected units (layers, experts, rows) of the
	  non-control repositories, hashed per range, so their projections
	  rest on real bytes. About 50 GB for the default list.

config KNLP_WEIGHT_IO_TRACER_REPO
	string "Tracer repository (ebpf-syscall)"
	default "https://github.com/SamsungDS/ebpf-syscall.git"

config KNLP_WEIGHT_IO_TRACER_REF
	string "Tracer git ref"
	default "main"
	help
	  The NVMe tracepoint monitor, the syscall capture and the page
	  fault tracer are built from this ref with clang, bpftool and
	  libbpf. The syscall capture needs the joined-record version
	  (schema syscall-capture-v2).

config KNLP_WEIGHT_IO_TRACER_DIR
	string "Existing tracer checkout with built binaries"
	default ""
	help
	  When set, no clone or build happens; the directory must contain
	  nvme_tp_monitor, syscall_monitor and mmap_readamp.

config KNLP_WEIGHT_IO_DISK
	string "Block device to trace (empty: derived from the data root)"
	default ""
	help
	  The whole-disk name, for example nvme0n1. Left empty, the device
	  and partition start are derived from the mount that holds the
	  data root.

config KNLP_WEIGHT_IO_GROUPS
	string "Replay groups"
	default "layers rows chunks awq"
	help
	  layers: first, middle and last decoder layer of every control
	  under pread, mmap and O_DIRECT, cold and warm page cache.
	  rows: single embedding rows of the smallest control.
	  chunks: one dense layer as contiguous O_DIRECT chunks of 4 KiB to
	  1 MiB at queue depths 1 to 32.
	  awq: selected INT4 neuron slices, clustered and scattered.

config KNLP_WEIGHT_IO_TRIALS
	int "Trials per run"
	default 5

config KNLP_WEIGHT_IO_INTENT
	bool "Record the reader's own file calls and page faults"
	default y
	help
	  Runs syscall_monitor and mmap_readamp on every reader beside the
	  NVMe tracer, so each run reports the bytes the reader asked for
	  (observed intent) next to the bytes the device moved.

config KNLP_WEIGHT_IO_IDLE_PROBE
	bool "Probe the device's idle-exit latency"
	default y
	help
	  One aligned 4 KiB O_DIRECT read after idle gaps from 0 to 2 s,
	  which separates a power-state exit from the loaded read latency.

config KNLP_WEIGHT_IO_GPU
	bool "Consume real layers on the GPU"
	default n
	help
	  Needs torch with a GPU and transformers. Loads the smallest
	  control natively and decodes under the tracers, and streams one
	  BF16 and one AWQ layer from the device through the GPU.

config KNLP_WEIGHT_IO_GPU_LAYER
	int "Decoder layer streamed through the GPU"
	default 13

config KNLP_WEIGHT_IO_PYTHON
	string "Python interpreter for the GPU stage"
	default "python3"
	help
	  An interpreter with torch, transformers and safetensors. The
	  inventory, fetch and replay stages use the invoking python3.

config KNLP_WEIGHT_IO_OWNER
	string "Owner recorded in the artifact manifest"
	default ""

endif

endmenu
```
