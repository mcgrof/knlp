## Kconfig.modular
```kconfig
# SPDX-License-Identifier: MIT
#
# Modular build-system A/B reproduction.

menu "Modular build-system reproduction"

config KNLP_MODULAR_REPRO
	bool "Enable Modular build-system reproduction"
	default n
	help
	  Build the same pinned Modular target with its reference builder, an
	  externally supplied alternative builder, or both. The public harness
	  knows only the adapter contract; alternative implementations remain
	  outside this repository.

choice
	prompt "Modular builder selection"
	depends on KNLP_MODULAR_REPRO
	default KNLP_MODULAR_BUILDER_REFERENCE
	help
	  REFERENCE builds only with Modular's Bazel wrapper.
	  ALTERNATIVE builds only with an external adapter.
	  A/B sends the same canonical request to both adapters.

config KNLP_MODULAR_BUILDER_REFERENCE
	bool "Reference Modular builder only"

config KNLP_MODULAR_BUILDER_ALTERNATIVE
	bool "Alternative Modular builder only"

config KNLP_MODULAR_BUILDER_AB
	bool "A/B: reference and alternative builders"

endchoice

config KNLP_MODULAR_SOURCE_DIR
	string "Pinned Modular source directory"
	default "/data/modular"
	depends on KNLP_MODULAR_REPRO

config KNLP_MODULAR_SOURCE_COMMIT
	string "Required Modular source commit"
	default "cc7155d854a049dce99aefc8d2570311e1e0b15f"
	depends on KNLP_MODULAR_REPRO
	help
	  Exact public Modular revision used by the workload. Leave empty only
	  when deliberately testing another recorded revision.

config KNLP_MODULAR_TARGET
	string "Modular target"
	default "//mojo/examples/gpu-block-and-warp:tiled_matmul"
	depends on KNLP_MODULAR_REPRO

config KNLP_MODULAR_ARTIFACT_RELPATH
	string "Artifact path relative to the configured binary directory"
	default "mojo/examples/gpu-block-and-warp/tiled_matmul"
	depends on KNLP_MODULAR_REPRO

config KNLP_MODULAR_BUILD_ARGS
	string "Common Modular build arguments"
	default ""
	depends on KNLP_MODULAR_REPRO
	help
	  Shell-style argument list passed unchanged to every builder.

config KNLP_MODULAR_JOBS
	int "Parallel build jobs (0 = detected CPU count)"
	default 0
	range 0 512
	depends on KNLP_MODULAR_REPRO

config KNLP_MODULAR_RESULTS_ROOT
	string "Build-system reproduction results root"
	default "./results/modular-tiled-matmul"
	depends on KNLP_MODULAR_REPRO

config KNLP_MODULAR_REFERENCE_BUILDER
	string "Reference builder adapter"
	default "tools/reproduce/modular_ab/builders/bazel.py"
	depends on KNLP_MODULAR_REPRO && !KNLP_MODULAR_BUILDER_ALTERNATIVE

config KNLP_MODULAR_ALTERNATIVE_BUILDER
	string "Alternative builder adapter"
	default ""
	depends on KNLP_MODULAR_REPRO && !KNLP_MODULAR_BUILDER_REFERENCE
	help
	  Executable implementing the public JSON builder contract. It can also
	  be supplied with MODULAR_ALT_BUILDER=/path/to/adapter.

config KNLP_MODULAR_BAZEL_BIN
	string "Reference Bazel executable"
	default "./bazelw"
	depends on KNLP_MODULAR_REPRO && !KNLP_MODULAR_BUILDER_ALTERNATIVE

config KNLP_MODULAR_PROFILE
	bool "Capture build profiles"
	default y
	depends on KNLP_MODULAR_REPRO

config KNLP_MODULAR_FAIL_ON_DIRTY_SOURCE
	bool "Reject dirty Modular source"
	default y
	depends on KNLP_MODULAR_REPRO
	help
	  Set MODULAR_ALLOW_DIRTY=1 for an intentional local source change.

config KNLP_MODULAR_RUNTIME_ARGS
	string "Common runtime arguments"
	default ""
	depends on KNLP_MODULAR_REPRO

config KNLP_MODULAR_RUNTIME_WARMUPS
	int "Warm-up runs per artifact"
	default 1
	range 0 100
	depends on KNLP_MODULAR_REPRO

config KNLP_MODULAR_RUNTIME_RUNS
	int "Measured runs per artifact"
	default 10
	range 1 1000
	depends on KNLP_MODULAR_REPRO

config KNLP_MODULAR_RUNTIME_TIMEOUT
	int "Runtime timeout in seconds"
	default 300
	range 1 86400
	depends on KNLP_MODULAR_REPRO

config KNLP_MODULAR_RUNTIME_MARKER
	string "Required successful-runtime output"
	default "Validation PASSED"
	depends on KNLP_MODULAR_REPRO

config KNLP_MODULAR_DRY_RUN
	bool "Emit requests without invoking builders"
	default n
	depends on KNLP_MODULAR_REPRO

endmenu
```

## Kconfig.pd
```kconfig
# SPDX-License-Identifier: MIT
# Configuration for the storage-mediated prefill/decode reproduction.
#
# Selecting one of the pd-* defconfigs sets these values.  After defconfig
# selection, plain `make` runs the configured rungs via Makefile.pd.  All
# symbols are namespaced CONFIG_KNLP_PD_* so this profile is self-contained
# and never collides with another reproduce profile.

menu "Storage-mediated prefill/decode reproduction"

config KNLP_REPRODUCE_PD
	bool "Enable storage-mediated prefill/decode reproduction"
	default n
	help
	  Set by defconfig-pd-smoke and its device/GPU siblings.  When set,
	  plain `make` runs the acceptance ladder that decides whether a KV
	  cache can be handed from a prefill node to a decode node through
	  NVMe instead of over the network.

	  The ladder is ten rungs.  pd-smoke runs the two that need neither a
	  GPU nor a claimed NVMe namespace, so it is safe in CI.

if KNLP_REPRODUCE_PD

config KNLP_PD_RUNGS
	string "Rungs to run (comma separated, or 'smoke')"
	default "smoke"
	help
	  smoke     rungs 1-2, CPU and file only
	  device    rungs 3,4,8 -- needs KNLP_PD_DEVICE_SERIAL
	  2gpu      rung 5
	  inference rungs 6,7,9 -- needs vLLM and a model

config KNLP_PD_DEVICE_SERIAL
	string "NVMe namespace serial the rungs may write to"
	default ""
	help
	  The drive is named by SERIAL, never by kernel name: names such as
	  nvme1n1 are not stable across reboots and have already moved once
	  on the reference host.  The runner resolves the serial through
	  /dev/disk/by-id, reads it back from sysfs, and refuses to run if it
	  does not match or if anything is mounted on the device.

	  Empty means no rung may touch a block device.

config KNLP_PD_RANGE_OFFSET
	int "First byte of the device the rungs may write"
	default 0

config KNLP_PD_RANGE_LEN
	int "Bytes from the offset the rungs may write"
	default 1073741824

config KNLP_PD_PATH
	string "Which P/D implementation: nixl or lmcache"
	default "nixl"
	help
	  nixl     the vLLM storage handoff connector over a NIXL backend
	  lmcache  LMCache raw_block talking to the device directly

config KNLP_PD_NIXL_BACKEND
	string "NIXL backend when KNLP_PD_PATH is nixl"
	default "XNVME_NVM"
	help
	  XNVME_NVM  io_uring, O_DIRECT, optionally dma-buf registered
	  GDS        cuFile/GPUDirect Storage, the baseline to beat

	  GDS silently falls back to a host-staged compatibility mode when
	  the IOMMU is translating, which gdscheck reports as
	  "NVMe : compat".  A GDS number taken in that state is a
	  host-staged number and must be labelled as one.

config KNLP_PD_TARGET
	string "Where the KV lands: block, xfs or ext4"
	default "block"
	help
	  block  the raw namespace or a partition of it
	  xfs    a file on an XFS filesystem
	  ext4   a file on an ext4 filesystem

config KNLP_PD_BLOCK_PARTITION
	int "Partition number to use for the block target (0 = whole namespace)"
	default 0
	help
	  Writing at offset 0 of a partitioned namespace destroys its
	  partition table, so a run that shares a drive with filesystems
	  must name a partition here.

config KNLP_PD_XFS_MOUNT
	string "Mount point of the XFS target"
	default "/mnt/pd-xfs"

config KNLP_PD_EXT4_MOUNT
	string "Mount point of the ext4 target"
	default "/mnt/pd-ext4"

config KNLP_PD_ITERATIONS
	int "Repeats per arm"
	default 5
	help
	  A single run of anything is a number without an error bar.  The
	  arms are interleaved across iterations so that drift in the device
	  cannot be mistaken for a difference between them.

config KNLP_PD_STAGING
	string "Staging exporter: host, system_heap, udmabuf, udmabuf_hugetlb, cuda"
	default "host"
	help
	  Where the KV is staged before it reaches the device.  Only cuda
	  keeps the payload in GPU memory; the others are host memory even
	  when they hand out a dma-buf, so a result from them is not a
	  GPU-direct result.

config KNLP_PD_BUFFER_MODE
	string "Buffer mode: host, fixed or dmabuf"
	default "host"
	help
	  dmabuf requires a staging exporter that produces one, and the
	  connector refuses the mismatch rather than falling back quietly.

config KNLP_PD_GPU_PRODUCER
	int "GPU ordinal for the producer"
	default 0

config KNLP_PD_GPU_CONSUMER
	int "GPU ordinal for the consumer"
	default 1

config KNLP_PD_MODEL
	string "Model for the inference rungs"
	default "meta-llama/Llama-3.2-1B-Instruct"
	help
	  These rungs prove correctness, not throughput, so the smallest
	  model that exercises the path is the right one.

endif # KNLP_REPRODUCE_PD

endmenu
```
