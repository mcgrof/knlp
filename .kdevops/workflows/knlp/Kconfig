## Kconfig.kvtide
```kconfig
# SPDX-License-Identifier: MIT
#
# KVTide -- portable, vendor-neutral tiered KV-cache I/O harness.
#
# Every experimental knob lives here so nothing is buried in shell
# constants; the stage scripts under tools/reproduce/kvtide/ source the
# generated .config and never hard-code experiment policy.

menu "KVTide NVMe-KV bench harness"

config KVTIDE
	bool "Enable the KVTide NVMe-KV bench harness"
	default n
	help
	  KVTide stands up a software NVMe key-value target (the SPDK
	  kvmalloc KV bdev exported over NVMe-oF/TCP on loopback) and
	  drives it with one or two initiators over the exact same
	  matrix: the SPDK userspace kernel-bypass initiator
	  (spdk_nvme_perf KV mode) and the xNVMe io_uring_cmd initiator,
	  which goes through the kernel nvme-tcp host stack and a
	  /dev/ngXnY char device. Identical workload, identical CPU
	  accounting, one CSV -- easy A/B.

	  No KV hardware is required: the target is pure software, so
	  the whole harness runs inside a QEMU guest (see the kdevops
	  integration in tools/reproduce/kvtide/README.md).

	  Off by default so it never perturbs existing knlp defconfigs
	  or make check.

if KVTIDE

choice
	prompt "Initiator selection"
	default KVTIDE_INITIATOR_BOTH
	help
	  Which initiator(s) to build and bench against the target.

config KVTIDE_INITIATOR_SPDK
	bool "SPDK userspace initiator (kernel-bypass)"
	help
	  Only spdk_nvme_perf in KV mode, connecting straight to the
	  NVMe-oF/TCP target from userspace.

config KVTIDE_INITIATOR_XNVME
	bool "xNVMe io_uring_cmd initiator (kernel nvme-tcp)"
	help
	  Only the xNVMe path: the kernel nvme-tcp host attaches the
	  target as a KV namespace char device (/dev/ngXnY) and
	  xnvme_kv_perf drives it with io_uring passthrough commands.

config KVTIDE_INITIATOR_BOTH
	bool "Both initiators (A/B bake-off)"
	help
	  Build and bench both initiators against the same target with
	  the same matrix and CPU accounting. Every cell lands in the
	  same CSV tagged by initiator, so the A/B comparison is one
	  sort away.

endchoice

config KVTIDE_SPDK
	bool
	default y if KVTIDE_INITIATOR_SPDK || KVTIDE_INITIATOR_BOTH

config KVTIDE_XNVME
	bool
	default y if KVTIDE_INITIATOR_XNVME || KVTIDE_INITIATOR_BOTH

menu "Sources"

config KVTIDE_SRC_DIR
	string "Source and build directory"
	default "/data/kvtide"
	help
	  Where KVTide clones and builds SPDK, xNVMe and (optionally)
	  NIXL, and where results land. The default matches the kdevops
	  guest layout where /data is the large data disk; point it
	  anywhere writable on other hosts. Use a path without spaces.

config KVTIDE_SPDK_GIT
	string "SPDK git URL"
	default "https://review.spdk.io/spdk/spdk"
	help
	  The SPDK KV command set target stack (bdev/kvmalloc, nvmf KV
	  namespace support, spdk_nvme_perf KV mode) is in review on
	  SPDK Gerrit; a single change ref carries the whole stack plus
	  its base.

config KVTIDE_SPDK_REF
	string "SPDK ref to fetch"
	default "refs/changes/07/28307/12"
	help
	  Gerrit change ref for the KV target stack. Patchset 12 is the
	  pinned, validated one; newer patchsets may exist. The ref is
	  fetched directly into FETCH_HEAD, no full clone needed.

config KVTIDE_SPDK_LOCAL_FIXES
	bool "Apply local SPDK build fixes"
	default y
	help
	  Apply tools/reproduce/kvtide/patches/spdk-kv-stack-local-fixes
	  .patch: a GCC 15 / AVX10 probe fix in mk/spdk.common.mk, an
	  rpc_autogen decoder-name collision fix in the kvmalloc RPCs,
	  and the matching CLI/lint updates. Without it the stack does
	  not build on current toolchains.

config KVTIDE_XNVME_GIT
	string "xNVMe git URL"
	default "https://github.com/xnvme/xnvme.git"

config KVTIDE_XNVME_REF
	string "xNVMe ref to check out"
	default "a5bf2a654ca038b246ed2fc9a64d81556a510ff6"
	help
	  Pinned upstream commit (v0.7.5-era master) validated with the
	  io_uring_cmd backend. A branch name works too but loses
	  bit-exact reproducibility.

config KVTIDE_NIXL
	bool "Also build the NIXL XNVME_KV plugin and run its tests"
	default n
	help
	  Fetch and build NIXL with the XNVME_KV storage plugin (an
	  NVMe-KV backend over xNVMe io_uring_cmd), run its mock-device
	  unit tests, and run its hardware integration test against the
	  KVTide target device. This validates a full transfer-library
	  data path on top of the same target the perf initiators use.

config KVTIDE_NIXL_GIT
	string "NIXL git URL"
	depends on KVTIDE_NIXL
	default "https://github.com/mcgrof/nixl.git"

config KVTIDE_NIXL_REF
	string "NIXL branch or ref"
	depends on KVTIDE_NIXL
	default "20260717-xnvme-kv"
	help
	  Branch carrying the XNVME_KV plugin series (scaffolding and
	  device layer, async data path, unit and integration tests,
	  docs and focused benchmark).

endmenu

menu "Target"

config KVTIDE_TARGET_ADDR
	string "Target listen address"
	default "127.0.0.1"

config KVTIDE_TARGET_PORT
	string "Target listen port"
	default "4420"

config KVTIDE_TARGET_NQN
	string "Target subsystem NQN"
	default "nqn.2016-06.io.spdk:cnode_kv"

config KVTIDE_TARGET_CORE_MASK
	string "Target reactor core mask"
	default "0x3"
	help
	  Cores the SPDK target busy-polls on. These cores are excluded
	  from initiator CPU accounting in the bench; keep the mask and
	  the bench pin (KVTIDE_BENCH_INIT_CORE) disjoint.

config KVTIDE_HUGEPAGES
	int "Number of 2 MiB hugepages for the target"
	default 1024
	help
	  Written to /proc/sys/vm/nr_hugepages before target start. The
	  default reserves 2 GiB. KVTide never runs SPDK setup.sh and
	  never rebinds PCI devices; local NVMe stays kernel-owned.

config KVTIDE_TARGET_INCAPSULE
	int "Transport in-capsule data size in bytes"
	default 8192
	help
	  Passed to nvmf_create_transport -u. Writes no larger than
	  this ride in the command capsule; larger ones go through the
	  solicited-write (R2T) round trip on the kernel nvme-tcp path.
	  This is exactly the knob behind the documented large-value
	  store sensitivity at queue depth -- sweep it to study that
	  behavior instead of accepting the default.

endmenu

menu "Kernel under test"

config KVTIDE_LINUX
	bool "Build, install and gate on a kernel under test"
	default n
	help
	  Fetch and build a Linux tree, install it on this host, and
	  gate the pipeline on actually running it: the first make
	  stops after the install and asks for one reboot; re-running
	  make after the reboot passes the gate and proceeds to the
	  bench on the kernel under test. This pairs the xNVMe
	  initiator's kernel data path with a kernel of choice -- the
	  default tree and branch carry the blk_iobuf_pool series.

	  Meant for disposable bench hosts (kdevops QEMU guests): the
	  stage installs a kernel and updates the bootloader.

if KVTIDE_LINUX

# CLI overrides for the kernel tree/branch, resolved at defconfig
# time.  Both
#   make defconfig-kvtide-ab-linux LINUX_TREE=<url>
#   make defconfig-kvtide-ab-linux LINUX_BRANCH=<ref>
# work; unset ones fall back to the blk_iobuf_pool defaults below.
# The kvtide-ab-linux defconfig deliberately omits the two string
# symbols so olddefconfig fills them from these defaults.
config KVTIDE_LINUX_TREE_SET_BY_CLI
	bool
	default $(shell, scripts/check-cli-set-var.sh LINUX_TREE)

config KVTIDE_LINUX_BRANCH_SET_BY_CLI
	bool
	default $(shell, scripts/check-cli-set-var.sh LINUX_BRANCH)

config KVTIDE_LINUX_TREE
	string "Linux git tree"
	default "$(LINUX_TREE)" if KVTIDE_LINUX_TREE_SET_BY_CLI
	default "https://git.kernel.org/pub/scm/linux/kernel/git/mcgrof/linux.git"

config KVTIDE_LINUX_BRANCH
	string "Linux branch or ref"
	default "$(LINUX_BRANCH)" if KVTIDE_LINUX_BRANCH_SET_BY_CLI
	default "blk-iobuf-pool-v3"

config KVTIDE_LINUX_ENABLE_BLK_IOBUF_POOL
	bool "Enable CONFIG_BLK_IOBUF_POOL in the built kernel"
	default y
	help
	  Turn on the per-queue large-folio buffer pool in the kernel
	  under test (the built config is otherwise based on the
	  running kernel's). Warns instead of failing when the chosen
	  tree does not carry the option.

config KVTIDE_LINUX_ALLOW_BAREMETAL
	bool "Allow the kernel stage on bare metal"
	default n
	help
	  The kernel stage installs a kernel and updates the
	  bootloader. Inside a VM that is always fine -- the host is
	  disposable. On bare metal it changes what your real machine
	  boots, so the stage refuses to run when systemd-detect-virt
	  reports no virtualization unless this option says otherwise.
	  The perf harness itself (target + bench) needs no such gate;
	  it runs on bare metal as-is.

endif

endmenu

menu "Bench matrix"

config KVTIDE_BENCH_OPS
	string "Operations to sweep"
	default "store retrieve"

config KVTIDE_BENCH_VSIZES
	string "Value sizes in bytes to sweep"
	default "4096 65536"

config KVTIDE_BENCH_QDS
	string "Queue depths to sweep"
	default "1 16 64"

config KVTIDE_BENCH_SECS
	int "Seconds per cell"
	default 8

config KVTIDE_BENCH_INIT_CORE
	int "CPU core the initiator is pinned to"
	default 4
	help
	  Both initiators are pinned here with taskset so their CPU
	  cost is measured the same way. Must not overlap the target
	  core mask.

endmenu

endif

endmenu
```

## Kconfig.lmcache_snapkv
```kconfig
# SPDX-License-Identifier: MIT
# LMCache SDK SnapKV reproduction configuration.

menu "LMCache SnapKV token-dropping reproduction"

config KNLP_LMCACHE_SNAPKV
	bool "Enable the LMCache SDK SnapKV reproduction"
	default n
	help
	  Run a baseline and a SnapKV-compacted workload through a real vLLM
	  server and LMCache's multiprocess SDK connector. The workload records
	  answer accuracy, decode throughput, and the exact software revisions.

if KNLP_LMCACHE_SNAPKV

config KNLP_SNAPKV_WORK_ROOT
	string "Build and source directory"
	default "./build/lmcache-snapkv"

config KNLP_SNAPKV_RESULTS_ROOT
	string "Results directory"
	default "./results/lmcache-snapkv"

config KNLP_SNAPKV_LMCACHE_REPO
	string "LMCache repository"
	default "https://github.com/LMCache/LMCache.git"

config KNLP_SNAPKV_LMCACHE_REF
	string "LMCache reference"
	default "dev"

config KNLP_SNAPKV_VLLM_VERSION
	string "vLLM version"
	default "0.23.0"

config KNLP_SNAPKV_PYTHON
	string "Python interpreter used to create the environment"
	default "python3.12"

config KNLP_SNAPKV_MODEL
	string "Model"
	default "Qwen/Qwen3-1.7B"

config KNLP_SNAPKV_DATASET
	string "Evaluation dataset"
	default "raniayu/token-dropping-demo-short"

config KNLP_SNAPKV_NUM_PROMPTS
	int "Number of prompts"
	default 10
	range 1 1000

config KNLP_SNAPKV_MAX_TOKENS
	int "Decode tokens per prompt"
	default 256
	range 1 4096

config KNLP_SNAPKV_DROP_RATIO
	string "Fraction of prompt tokens to drop"
	default "0.5"

config KNLP_SNAPKV_WINDOW_SIZE
	int "Recent-token window"
	default 64
	range 1 4096

config KNLP_SNAPKV_GPU_MEMORY_UTILIZATION
	string "vLLM GPU memory utilization"
	default "0.35"

config KNLP_SNAPKV_L1_SIZE_GB
	string "LMCache L1 size in GiB"
	default "3"

config KNLP_SNAPKV_CUDA_VISIBLE_DEVICES
	string "CUDA devices visible to the run"
	default "0"

endif # KNLP_LMCACHE_SNAPKV

endmenu
```

## Kconfig.memorilla
```kconfig
# SPDX-License-Identifier: MIT
menuconfig KNLP_REPRODUCE_MEMORILLA
	bool "Memorilla checkpoint inference and stress replay"
	default n
	help
	  Run released author checkpoints with the original prompts, reader,
	  decoder and scorers. No training target is provided.

if KNLP_REPRODUCE_MEMORILLA
choice
	prompt "Memorilla inference path"
config KNLP_MEM_AUTHOR
	bool "Original author runtime and mmap store"
config KNLP_MEM_PORT_CONTROL
	bool "Original mmap store on a separately recorded runtime"
config KNLP_MEM_LMCACHE
	bool "Shared artifact catalog and LMCache embedding store"
endchoice
config KNLP_MEM_ROOT
	string "Local persistent source, model and run root"
	default "build/memorilla"
config KNLP_MEM_BENCHMARK
	string "Benchmark name or all"
	default "pubmedqa"
config KNLP_MEM_BATCH
	int "Generation batch size"
	range 1 256
	default 32
config KNLP_MEM_SCHEDULING
	string "Offline scheduling: runtime, inprocess, batch"
	default "runtime" if KNLP_MEM_AUTHOR
	default "inprocess"
	help
	  Runtime preserves upstream defaults. Inprocess disables V1 engine
	  multiprocessing for repeatable offline scheduling. Batch keeps V1
	  multiprocessing and pauses scheduling while a complete batch is
	  enqueued; it requires the level-0 pause/enqueue APIs. Original author
	  mode accepts runtime only. Neither mode promises equality between
	  different batch shapes or engine/hardware versions.
config KNLP_MEM_SINGLETON_REFERENCE
	bool "Isolated single-request numerical reference"
	depends on !KNLP_MEM_AUTHOR
	default n
	help
	  Require batch size one, inprocess scheduling, one engine sequence
	  and disabled prefix caching. This removes neighboring requests and
	  prefix reuse from the numerical reference. It is a correctness
	  control, not a throughput configuration or a paper-score target.
config KNLP_MEM_GPU_FRACTION
	string "Decoder GPU memory fraction"
	default "0.6"
config KNLP_MEM_SCORER_FRACTION
	string "Scoring encoder GPU memory fraction"
	default "0.3"
config KNLP_MEM_POOL_BYTES
	int "LMCache host arena bytes"
	default 67108864
config KNLP_MEM_INPUT_PIPELINE
	string "Document batch assembly: author, leased-fp16, leased-bf16"
	default "author"
	help
	  The port and LMCache paths may copy document banks directly into an
	  owned batch. leased-fp16 removes the intermediate bank clone while
	  preserving the original padded conversion. leased-bf16 casts valid
	  rows directly into the final batch and initializes padding there.
	  Both preserve complete reader inputs and bounded source lifetimes.
	  Original author mode accepts author only.
config KNLP_MEM_ARTIFACT_MODE
	string "LMCache artifact setup: import or attach"
	default "import"
	help
	  Import validates and publishes document collections. Attach opens
	  an explicitly pinned imported set without reconstructing collections.
	  Payload misses still verify complete bytes and catalog identity.
config KNLP_MEM_ARTIFACT_SET_MANIFEST
	string "Receipt from memorilla-import for attach mode"
	default ""
config KNLP_MEM_ENGINE_JSON
	string "Port-only vLLM engine options JSON"
	default "{}"
	help
	  Explicit engine options for the port control and LMCache path only.
	  For example, enforce_eager can qualify an existing native build.
	  Original author mode rejects overrides. Sampling stays unchanged.
config KNLP_MEM_REQUESTS
	int "Stress requests per benchmark"
	range 1 10000000
	default 1000
config KNLP_MEM_CLIENTS
	int "Concurrent bank-fetch clients before each ordered decoder batch"
	range 1 128
	default 1
	help
	  Port stress replay can fetch collections concurrently while preserving
	  the original collator and complete decoder batch order. This exercises
	  shared-bank storage contention, not concurrent engine.generate calls.
	  Original author mode requires one client.
config KNLP_MEM_PATTERN
	string "Stress pattern: sequential, shuffle, random, hot"
	default "shuffle"
config KNLP_MEM_BANK_SWAP
	bool "Stress one question against different document collections"
	default n
	help
	  Synthetic inference isolation workload. Keep question zero and
	  replay the selected collection schedule. These pairs are not scored
	  as paper benchmark examples. Compare them against native inference.
config KNLP_MEM_DIAGNOSTICS
	bool "Hash collated inputs, reader outputs and decoder prompt tensors"
	default n
	help
	  Diagnostic replay only. Copy intermediate tensors to CPU and hash
	  them per request to locate output mismatches. Extra synchronization
	  changes timing; do not use this mode to claim a performance result.
config KNLP_MEM_SEED
	int "Request and evaluation seed"
	default 23
config KNLP_MEM_ROWS
	int "Stress working set in questions; zero means full split"
	range 0 1000000
	default 0
config KNLP_MEM_EVICT_EVERY
	int "Evict adapter residency every N batches; zero disables"
	range 0 1000000
	default 0
endif
```
