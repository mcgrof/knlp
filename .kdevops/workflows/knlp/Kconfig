## research/cartridges_cas/Kconfig
```kconfig
# Cartridges-at-Scale (CAS) collapse->rescue replication.
# Sourced from the top-level knlp Kconfig. Every experimental knob lives here so
# nothing is buried in Python constants; the driver reads a JSON generated from
# .config (scripts/gen_config_json.py) and never hard-codes experiment policy.
#
# CAS (arXiv:2606.04557) trains one KV-cache "cartridge" per document. Loading N
# independently-trained cartridges at inference collapses accuracy toward chance;
# mixed-visibility (joint) training rescues it. This harness reproduces that
# split on Qwen3-8B / LongHealth. It depends on the HazyResearch cartridges
# package (pinned + patched by bootstrap.sh) and a GPU + vLLM for synthesis.

menu "Cartridges-at-Scale (CAS) replication"

config CARTRIDGES_CAS
	bool "Enable the CAS collapse->rescue replication harness"
	default n
	help
	  Master switch. Off by default so it never perturbs existing knlp
	  defconfigs or `make check`. When on, `make` bootstraps the pinned+
	  patched cartridges package and runs the pipeline selected below.

choice
	prompt "Scale"
	depends on CARTRIDGES_CAS
	default CARTRIDGES_CAS_SMOKE
	help
	  Which replication scale to run.

config CARTRIDGES_CAS_SMOKE
	bool "Smoke (few patients, fast, recipe validation)"
	help
	  A small, fast run to validate the pipeline end to end and check that a
	  single cartridge oracle beats its no-context floor.

config CARTRIDGES_CAS_PAPER
	bool "Paper-faithful (full panel, collapse + rescue)"
	help
	  The headline replication: train the full patient panel, show the
	  isolated collapse, then the mixed-visibility rescue.

endchoice

menu "Model and data"
	depends on CARTRIDGES_CAS

config CARTRIDGES_CAS_MODEL
	string "Base model (frozen; only the KV cache trains)"
	default "Qwen/Qwen3-8B"

config CARTRIDGES_CAS_NUM_PATIENTS
	int "Number of LongHealth patients (cartridges)"
	default 5 if CARTRIDGES_CAS_SMOKE
	default 20 if CARTRIDGES_CAS_PAPER
	help
	  One cartridge per patient. More co-loaded cartridges give a stronger
	  collapse signal.

config CARTRIDGES_CAS_CONVOS_PER_PATIENT
	int "Self-study convos synthesized per patient"
	default 8000 if CARTRIDGES_CAS_SMOKE
	default 8000 if CARTRIDGES_CAS_PAPER
	help
	  The dominant quality lever, and the binding constraint. 400 is far too
	  few (cartridge stays below its floor). 8000 makes some cartridges beat
	  their floor but does not generalize across patients (8-patient mean
	  oracle ~12.5%). The paper's regime is ~40000; expect synthesis to
	  dominate wall-clock at that scale (~5 h/patient of vLLM generation).

config CARTRIDGES_CAS_MIN_PROB_MASS
	string "Teacher top-k cumulative mass kept (richer distillation)"
	default "0.998"
	help
	  Nucleus cutoff on the captured teacher logprobs. Lower values collapse
	  the top-k distribution toward a hard label; the flatten edge-case patch
	  keeps all K when this mass is never reached.

endmenu

menu "Cartridge and training"
	depends on CARTRIDGES_CAS

config CARTRIDGES_CAS_KV_TOKENS
	int "Cartridge size in KV tokens"
	default 512

config CARTRIDGES_CAS_LR
	string "Learning rate"
	default "1e-3"

config CARTRIDGES_CAS_GLOBAL_BATCH
	int "Global batch size (small -> more optimizer steps/epoch)"
	default 4

config CARTRIDGES_CAS_STEPS
	int "Max optimizer steps per cartridge"
	default 2000 if CARTRIDGES_CAS_SMOKE
	default 6000 if CARTRIDGES_CAS_PAPER

config CARTRIDGES_CAS_EPOCHS
	int "Epochs (upper bound; STEPS usually binds first)"
	default 4 if CARTRIDGES_CAS_SMOKE
	default 14 if CARTRIDGES_CAS_PAPER

config CARTRIDGES_CAS_COMPILE_FLEX
	bool "Compile FlexAttention (CUDA sm>=80; ~16x faster)"
	default y
	help
	  Restores the upstream compiled FlexAttention path. Disable only on
	  GPUs where compiled flex fails (e.g. AMD RDNA3 / W7900).

endmenu

menu "Phases"
	depends on CARTRIDGES_CAS

config CARTRIDGES_CAS_PHASE_SYNTH
	bool "Synthesize self-study corpora"
	default y

config CARTRIDGES_CAS_PHASE_TRAIN_ISOLATED
	bool "Train isolated cartridges"
	default y

config CARTRIDGES_CAS_PHASE_COLLAPSE
	bool "Combine-at-inference collapse eval"
	default y

config CARTRIDGES_CAS_PHASE_TRAIN_JOINT
	bool "Mixed-visibility (joint) training"
	default y if CARTRIDGES_CAS_PAPER
	default n if CARTRIDGES_CAS_SMOKE
	help
	  KNOWN-LIMITED. The current joint trainer uses a fixed-distractor,
	  always-joint approximation of CAS's per-sample P_iso, and the combined
	  joint cartridges collapse rather than rescue. A faithful per-sample
	  P_iso is the main TODO -- see research/cartridges_cas/README.md. Until
	  it lands, treat the rescue arm as unmeasured.

config CARTRIDGES_CAS_PHASE_RESCUE
	bool "Rescue eval on joint cartridges"
	default y if CARTRIDGES_CAS_PAPER
	default n if CARTRIDGES_CAS_SMOKE

config CARTRIDGES_CAS_PHASE_CONTROL_SCREEN
	bool "Control-aware fixed-trajectory objective screen"
	default n
	help
	  Gate 0 of the control-aware cartridge lane: decompose the legacy
	  stored-target objective into unique support plus explicit
	  chosen-token anchors and train one short matched arm per
	  construction (exact legacy reproduction control, dedup-only,
	  dedup scale-matched, control-position anchors, matched content
	  anchors) from one starting cartridge, one saved zero-moment
	  optimizer state, and one frozen example schedule. A no-training
	  parity arm proving legacy == unique + anchors in loss and
	  cartridge gradients runs first and gates the matrix. Requires a
	  stored self-study parquet (DATA_PARQUET), a starting cartridge
	  (CTRL_CART_INIT env), and one CUDA GPU able to hold the student
	  model; evaluation covers strict thinking-off generation,
	  thinking-on stress, forced-choice letter scoring, and
	  control-state probe diagnostics.

config CARTRIDGES_CAS_PHASE_OPT_ABLATION
	bool "Optimizer ablation (AdamW vs SOAP, matched arms)"
	default n
	help
	  Train one isolated cartridge from a shared truncation init with
	  the stored sparse top-k objective, once per optimizer arm, with
	  everything but the optimizer matched (init, data order, steps,
	  accumulation, learning rate, clipping). Reports loss at matched
	  steps and a CUDA-synchronized wall-clock split; the optimizer-step
	  share of total step time is the number that decides whether a
	  second-order optimizer is affordable in the small-trainable-set,
	  large-frozen-forward regime. Needs a stored self-study parquet
	  (DATA_PARQUET env or a prior synth phase). The SOAP eigenbasis
	  refresh needs a deterministic backward: run this on NVIDIA, not
	  on ROCm/W7900.

config CARTRIDGES_CAS_PHASE_PAPER_REGIME
	bool "Paper-regime isolated-cartridge confirmation"
	default n
	help
	  Train and evaluate a named patient list with the isolated recipe used
	  by the paper-quality baseline: document/20 KV tokens, 80 epochs, global
	  batch 128, peak LR 0.1, and a 5000-step linear schedule. The phase
	  consumes already-synthesized per-patient parquets from PAPER_DATA_DIR
	  and fails instead of silently changing the recipe if a GPU cannot hold
	  it. It records the source commit, config, hardware, input hashes,
	  logs, raw evaluation rows, and output hashes for audit and resumption.

endmenu

menu "Paper-regime confirmation"
	depends on CARTRIDGES_CAS_PHASE_PAPER_REGIME

config CARTRIDGES_CAS_PAPER_PATIENTS
	string "Patients to train (space-separated)"
	default "patient_02"

config CARTRIDGES_CAS_PAPER_KV_DIVISOR
	int "Document tokens per cartridge token"
	default 20

config CARTRIDGES_CAS_PAPER_EVAL_RUNS
	int "Independent Table-15 evaluation runs"
	default 3

endmenu

menu "Control-aware screen"
	depends on CARTRIDGES_CAS_PHASE_CONTROL_SCREEN

config CARTRIDGES_CAS_CTRL_ARMS
	string "Training arms (space-separated)"
	default "legacy_raw dedup_only dedup_scale_matched control_anchor content_anchor_matched"

config CARTRIDGES_CAS_CTRL_PATIENT
	string "LongHealth patient"
	default "patient_02"

config CARTRIDGES_CAS_CTRL_STEPS
	int "Optimizer steps per arm"
	default 10

config CARTRIDGES_CAS_CTRL_ACCUM
	int "Gradient-accumulation samples per step"
	default 8

config CARTRIDGES_CAS_CTRL_LR
	string "Learning rate (the legacy continuation trainer's value)"
	default "2e-2"

config CARTRIDGES_CAS_CTRL_SEED
	int "Seed (frozen schedule is generated from this seed)"
	default 0

config CARTRIDGES_CAS_CTRL_CHECKPOINT_AT
	string "Checkpoint steps (step 0 saves the starting state)"
	default "0,1,2,5,10"

config CARTRIDGES_CAS_CTRL_MAX_Q
	int "Held-out questions per generation eval"
	default 20

config CARTRIDGES_CAS_CTRL_PROBE_N
	int "Held-out elements in the control-state probe"
	default 16

endmenu

menu "Optimizer ablation"
	depends on CARTRIDGES_CAS_PHASE_OPT_ABLATION

config CARTRIDGES_CAS_OPT_ARMS
	string "Optimizer arms (space-separated)"
	default "adamw soap"

config CARTRIDGES_CAS_OPT_PATIENT
	string "LongHealth patient the cartridge trains on"
	default "patient_02"

config CARTRIDGES_CAS_OPT_STEPS
	int "Optimizer steps per arm (matched)"
	default 300

config CARTRIDGES_CAS_OPT_ACCUM
	int "Gradient-accumulation samples per step"
	default 8

config CARTRIDGES_CAS_OPT_LR
	string "Learning rate (matched across arms)"
	default "2e-2"

config CARTRIDGES_CAS_OPT_SEED
	int "Seed (data order is matched via this seed)"
	default 0

config CARTRIDGES_CAS_OPT_CHECKPOINT_AT
	string "Steps at which to save checkpoints for the strict eval"
	default "10,50,100,200,300"

config CARTRIDGES_CAS_OPT_SOAP_PRECOND_FREQ
	int "SOAP eigenbasis refresh period (optimizer steps)"
	default 10
	help
	  How many optimizer steps reuse one eigenbasis before the factor
	  eigendecompositions rerun. Larger amortizes the decomposition
	  cost further at the price of a staler basis.

endmenu

endmenu
```

## research/kv_translate/Kconfig
```kconfig
# SPDX-License-Identifier: MIT

menu "KV-Lingo cross-model cache translation"

config KV_LINGO
	bool "Enable the experimental KV-Lingo reproduction"
	default n
	help
	  Select the independent Qwen3-4B/8B KV-Lingo research harness. The
	  default target is an offline CPU regression suite. It does not fetch
	  models, allocate a GPU, or start training. Full fitting and evaluation
	  require explicit commands and caller-supplied paths; see
	  research/kv_translate/published/README.md.

config KV_LINGO_PYTHON
	string "Python interpreter for KV-Lingo checks"
	depends on KV_LINGO
	default "python3"
	help
	  Python environment with pytest, NumPy, and CPU PyTorch installed.

endmenu

menu "Mixture-of-Translators author-code baseline"

config MOT_AUTHOR_BASELINE
	bool "Enable the pinned MoT author-code readiness workflow"
	default n
	help
	  Select the external author-code audit and reproduction wrapper for
	  Mixture-of-Translators. Plain make runs CPU-only tests, provenance
	  checks, and readiness diagnostics. It does not download models,
	  allocate a GPU, train a translator, or run model evaluation.

config MOT_AUTHOR_PYTHON
	string "Python interpreter for MoT checks"
	depends on MOT_AUTHOR_BASELINE
	default "python3"
	help
	  Python environment with pytest and CPU PyTorch installed. The author
	  source pins older runtime dependencies; record the actual environment.

config MOT_AUTHOR_SOURCE
	string "Path to the unchanged pinned MoT author checkout"
	depends on MOT_AUTHOR_BASELINE
	default ""
	help
	  External prosopher/MoT checkout at commit 9753626a11b49b86ab940d87d9e5640958eb87d2.
	  The wrapper rejects another revision or a modified worktree. The
	  MOT_SOURCE make variable can override this value.

config MOT_AUTHOR_OUTPUT_DIR
	string "MoT result output directory"
	depends on MOT_AUTHOR_BASELINE
	default "mot-author-output"
	help
	  External directory for generated configs, readiness receipts, model
	  outputs, and checkpoints. Do not commit this directory to knlp.

endmenu
```
