## research/linear_attention/Kconfig
```kconfig
# Matched micro-scale training driver for the linear-attention program.
# Sourced from the top-level knlp Kconfig. The experimental knobs live here so
# nothing is buried in Python constants; the driver reads a JSON generated from
# .config (gen_config_json.py) and never hard-codes experiment policy.
#
# The harness itself is scripts/matched_micro_train.py: five arms (a
# full-attention control, two Gated DeltaNet hybrids, Titans, and Hope)
# trained under one matched contract — one tokenizer, one materialized
# TinyStories token stream consumed in the same order, one optimizer and
# schedule, parameter counts within tolerance. See that script's docstring.

menu "Matched micro-scale training (Titans/Hope vs hybrids)"

config MATCHED_MICRO
	bool "Enable the matched micro-scale training driver"
	default n
	help
	  Master switch for research/linear_attention/run.sh, the driver
	  around scripts/matched_micro_train.py. Off by default so it never
	  perturbs existing knlp defconfigs or `make check`. When on, the
	  driver materializes the shared token stream if missing and runs
	  the phases selected below on one GPU.

config MATCHED_MICRO_ARMS
	string "Arms to run"
	depends on MATCHED_MICRO
	default "hope"
	help
	  Space-separated subset of: attn gdn3 gdn7 titans hope. The hope
	  arm needs the pinned nested_learning package (the driver prepends
	  NESTED_LEARNING_SRC to PYTHONPATH); titans needs titans-pytorch
	  (TITANS_PYTORCH_DIR); the gdn arms need flash-linear-attention.

config MATCHED_MICRO_PHASE_BATCH_PROBE
	bool "Batch-throughput probe"
	depends on MATCHED_MICRO
	default n
	help
	  Short fixed-step training runs of the selected arms across a
	  ladder of batch sizes, recording tokens/second at each point.
	  Built for the Hope arm, whose per-token cost is dominated by
	  batch-invariant host-side work in its sequential self-modifying
	  chunk loop, so throughput saturates at a host-dependent batch
	  size instead of scaling with it. The saturation point sets the
	  arm's training schedule on the host at hand. Emits one run JSON
	  per point plus a summary table (probe_summary.md/.json).

config MATCHED_MICRO_PROBE_BATCHES
	string "Batch sizes for the probe ladder"
	depends on MATCHED_MICRO_PHASE_BATCH_PROBE
	default "8 32 64 128"

config MATCHED_MICRO_PROBE_STEPS
	int "Training steps per probe point"
	depends on MATCHED_MICRO_PHASE_BATCH_PROBE
	default 10
	help
	  Throughput stabilizes within a few steps; ten is enough for a
	  clean tokens/second reading while keeping the ladder cheap.

config MATCHED_MICRO_DATA_TOKENS
	int "Tokens to materialize for the shared stream"
	depends on MATCHED_MICRO
	default 40000000
	help
	  Target size for prepare-data (GPT-2 tokenized TinyStories,
	  ~80MB at the default). The driver materializes the stream only
	  when the token file is missing from DATA_DIR, so a pre-staged
	  cache is reused as-is and no network is needed.

config MATCHED_MICRO_PHASE_CAMPAIGN
	bool "Matched training campaign"
	depends on MATCHED_MICRO
	default n
	help
	  Full-token-budget training of every selected arm at every
	  selected seed, all at one shared batch size so the optimizer
	  schedule (updates at matched tokens, warmup fraction, cosine
	  decay) stays identical across arms. Each run writes its JSON
	  record and a final weight checkpoint, with validation loss
	  evaluated periodically. Enable the batch probe alongside as a
	  cheap pre-flight: a ten-step run of every arm at the campaign
	  batch catches an out-of-memory arm in minutes instead of hours.

config MATCHED_MICRO_CAMPAIGN_SEEDS
	string "Seeds"
	depends on MATCHED_MICRO_PHASE_CAMPAIGN
	default "1234 2027 31337"
	help
	  Space-separated contract-seed overrides, one full campaign pass
	  each. The seed controls model init; the token stream order is
	  fixed by design.

config MATCHED_MICRO_CAMPAIGN_BATCH
	int "Shared batch size for every arm"
	depends on MATCHED_MICRO_PHASE_CAMPAIGN
	default 128
	help
	  One batch for all arms keeps the comparison matched-schedule,
	  not just matched-token. Changing it changes update count at a
	  fixed token budget — record any deviation from the default with
	  the results.

config MATCHED_MICRO_CAMPAIGN_TOKEN_BUDGET
	int "Training-token budget per arm per seed"
	depends on MATCHED_MICRO_PHASE_CAMPAIGN
	default 40000000

config MATCHED_MICRO_CAMPAIGN_EVAL_EVERY
	int "Validation eval interval (steps)"
	depends on MATCHED_MICRO_PHASE_CAMPAIGN
	default 150
	help
	  Validation uses a capped batch set, so this mainly trades
	  curve resolution against wall-clock on the slowest arm.

config MATCHED_MICRO_PHASE_RANK_EVAL
	bool "Accountability option-ranking eval over saved checkpoints"
	depends on MATCHED_MICRO
	default n
	help
	  Generates one deterministic accountability-benchmark episode
	  set (scripts/accountability_bench.py) and scores every
	  campaign checkpoint found under CKPT_DIR by log-probability
	  option ranking (rank_eval.py, with per-arm audited scoring
	  semantics and a mandatory self-check), then scores predictions
	  with the benchmark's certified scorer and tables the result
	  (rank_summary). One shared episode set for all arms and seeds
	  keeps the test identical for everyone.

config MATCHED_MICRO_RANK_SEED
	int "Episode-set base seed"
	depends on MATCHED_MICRO_PHASE_RANK_EVAL
	default 7

config MATCHED_MICRO_RANK_PER_FAMILY
	int "Episodes per benchmark family"
	depends on MATCHED_MICRO_PHASE_RANK_EVAL
	default 25

config MATCHED_MICRO_RANK_CONTROLS
	string "Benchmark control overrides (JSON)"
	depends on MATCHED_MICRO_PHASE_RANK_EVAL
	default "{\"filler_sentences\": 2}"
	help
	  Passed to the generator's --controls. The default trims the
	  neutral filler so episodes fit the arms' trained 512-token
	  context; queries that still exceed it are skipped identically
	  for every arm and counted wrong by the scorer for everyone.

config MATCHED_MICRO_RANK_NORM
	string "Option ranking statistic (mean or sum)"
	depends on MATCHED_MICRO_PHASE_RANK_EVAL
	default "mean"
	help
	  mean = per-token log-probability (length-robust, the primary
	  statistic); raw sums are recorded alongside either way.

config MATCHED_MICRO_RANK_MAX_TOKENS
	int "Prompt token cap (the trained context length)"
	depends on MATCHED_MICRO_PHASE_RANK_EVAL
	default 512

config MATCHED_MICRO_RANK_TAG
	string "Subdirectory name for this eval's outputs"
	depends on MATCHED_MICRO_PHASE_RANK_EVAL
	default "rank-eval"
	help
	  Lets an ablation write beside the reference run instead of over
	  it, so both can be summarized and compared from one tree.

config MATCHED_MICRO_RANK_NO_MEMORY_UPDATE
	bool "Ablate Hope's retained state (skip the memory update)"
	depends on MATCHED_MICRO_PHASE_RANK_EVAL
	default n
	help
	  Scores the Hope arm with its teach-signal update pass skipped,
	  so the fast state stays at its initial value for the whole
	  sequence while the chunking, boundary targets and train-mode
	  forward stay exactly as trained. Answers whether Hope's ranking
	  accuracy comes from state it retains across the context or from
	  the scoring path itself: if accuracy holds up without updates,
	  the memory is not what earned it. No effect on the other arms,
	  so pair it with an arm list of just "hope".

config MATCHED_MICRO_RANK_NO_CONTEXT
	bool "Control: hide the episode text"
	depends on MATCHED_MICRO_PHASE_RANK_EVAL
	default n
	help
	  Scores the question and its options with the story removed. An
	  arm that keeps its accuracy under this was never reading the
	  context, which would mean the ranking measures how plausible
	  each option looks on its own rather than any state tracking.
	  Applies to every arm, so run it across the full arm list.

config MATCHED_MICRO_RANK_CHUNK_PATH
	int "Control: score stateless arms through Hope's chunking"
	depends on MATCHED_MICRO_PHASE_RANK_EVAL
	default 0
	help
	  Non-zero cuts the sequence into chunks of this size for the
	  stateless arms, scoring each on its own with its last position
	  predicting the next chunk's first token and nothing carried
	  across. Hope's forward only ever sees one chunk, so with its
	  memory frozen this is exactly Hope's information set: setting
	  this to Hope's chunk size (64) compares architectures at
	  matched visible context instead of handing the stack arms the
	  whole prompt. No effect on Hope itself.

config MATCHED_MICRO_RANK_SHARDS
	int "Concurrent shards per checkpoint"
	depends on MATCHED_MICRO_PHASE_RANK_EVAL
	default 1
	help
	  Split each checkpoint's query set across this many concurrent
	  processes on one GPU. Every query is scored independently from
	  a fresh state, so sharding is exact rather than an
	  approximation, and the shards' predictions are concatenated
	  before the certified scorer runs. The Hope arm is host-bound
	  and scores roughly one option per second per process, so its
	  sweep is impractical unsharded; the fast arms finish in a
	  minute either way. Size it by host CPU, not GPU memory (each
	  process holds a ~51M-parameter model, about 1.3GB).

endmenu
```

## research/reproduction/Kconfig
```kconfig
# SPDX-License-Identifier: MIT
menu "Residual-path research reproduction"

config RESIDUAL_REPRODUCTION
	bool "Run the configured MNIST or TinyStories study"
	default n

if RESIDUAL_REPRODUCTION

config RESIDUAL_STUDY
	string "Study: mnist, null, layerrope, tinystories, depth, confirmation, cache, gsm8k, beta, time-budget, routing-audit"
	default "mnist"

config RESIDUAL_SMOKE
	bool "Bounded smoke test; cannot issue a confirmation verdict"
	default n

config RESIDUAL_DEVICE
	string "Requested device: cpu or cuda"
	default "cuda"

config RESIDUAL_DATA_DIR
	string "Public dataset cache"
	default "~/.cache/knlp/residual-data"

config RESIDUAL_OUTPUT_DIR
	string "New output directory"
	default "~/knlp-residual-runs"

config RESIDUAL_CHECKPOINT_DIR
	string "Checkpoint root; empty keeps checkpoints within the run"
	default ""

config RESIDUAL_CPU_PYTHON
	string "Python interpreter for independent CPU evaluations"
	default "python3"

config RESIDUAL_SEEDS
	string "Optional seeds for a targeted MNIST study"
	default ""
	help
	  Aggregate studies retain their distinct original seed sets.
	  The seven-row confirmation always uses seeds 76411 through 76418.

config RESIDUAL_MAX_SECONDS
	int "Total elapsed-time limit; zero disables the limit"
	default 86400
	range 0 604800

config RESIDUAL_CPU_THREADS
	int "CPU thread limit"
	default 8
	range 1 64

config RESIDUAL_KV_CACHE
	bool "Evaluate KV-cache fake quantization after TinyStories training"
	default y
	help
	  Reuse saved final checkpoints. Keep the three-seed residual/mHC
	  cohort separate from the eight-seed depth-code confirmation.
	  No quantization-aware training or packed-kernel benchmark runs.

config RESIDUAL_CACHE_DEPTH_RUN
	string "Saved depth-screen reproduction run for cache-only evaluation"
	default ""
	help
	  The top-level external run directory containing depth-screen/ and
	  data/. Used by the cache-only and GSM8K presets; no training repeats.

config RESIDUAL_CACHE_CONFIRMATION_RUN
	string "Saved confirmation reproduction run for cache-only evaluation"
	default ""
	help
	  The top-level external run directory containing confirmation/.
	  Supply either saved cohort or both. Reports stay separate.

config RESIDUAL_TIME_CARD
	string "Frozen equal-time run card (JSON)"
	default ""

config RESIDUAL_TIME_RESOURCE
	string "Bounded, owner-authorized hardware/resource decision (JSON)"
	default ""

config RESIDUAL_TIME_ACTION
	string "Equal-time action: qualify or run"
	default "qualify"

config RESIDUAL_AUDIT_INPUTS
	string "Frozen routing replay inputs (JSON)"
	default ""

config RESIDUAL_AUDIT_ACTION
	string "Routing follow-up: audit or pilot"
	default "audit"

config RESIDUAL_AUDIT_RESULT
	string "Completed routing audit result for a conditional pilot"
	default ""

config RESIDUAL_AUDIT_PROPOSAL
	string "Frozen pilot proposal with fresh-seed provenance"
	default ""

endif
endmenu
```
